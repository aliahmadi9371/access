/*******************************************************************************
* File Name: cyfittergnu.inc
* 
* PSoC Creator  4.4
*
* Description:
* 
* This file is automatically generated by PSoC Creator.
*
********************************************************************************
* Copyright (c) 2007-2020 Cypress Semiconductor.  All rights reserved.
* You may use this file only in accordance with the license, terms, conditions, 
* disclaimers, and limitations in the end user license agreement accompanying 
* the software package with which this file was provided.
********************************************************************************/

.ifndef INCLUDED_CYFITTERGNU_INC
.set INCLUDED_CYFITTERGNU_INC, 1
.include "cydevicegnu.inc"
.include "cydevicegnu_trm.inc"

/* LED_RGB */
.set LED_RGB__0__INTTYPE, CYREG_PICU0_INTTYPE4
.set LED_RGB__0__MASK, 0x10
.set LED_RGB__0__PC, CYREG_PRT0_PC4
.set LED_RGB__0__PORT, 0
.set LED_RGB__0__SHIFT, 4
.set LED_RGB__1__INTTYPE, CYREG_PICU0_INTTYPE5
.set LED_RGB__1__MASK, 0x20
.set LED_RGB__1__PC, CYREG_PRT0_PC5
.set LED_RGB__1__PORT, 0
.set LED_RGB__1__SHIFT, 5
.set LED_RGB__2__INTTYPE, CYREG_PICU0_INTTYPE6
.set LED_RGB__2__MASK, 0x40
.set LED_RGB__2__PC, CYREG_PRT0_PC6
.set LED_RGB__2__PORT, 0
.set LED_RGB__2__SHIFT, 6
.set LED_RGB__AG, CYREG_PRT0_AG
.set LED_RGB__AMUX, CYREG_PRT0_AMUX
.set LED_RGB__BIE, CYREG_PRT0_BIE
.set LED_RGB__BIT_MASK, CYREG_PRT0_BIT_MASK
.set LED_RGB__BYP, CYREG_PRT0_BYP
.set LED_RGB__CTL, CYREG_PRT0_CTL
.set LED_RGB__DM0, CYREG_PRT0_DM0
.set LED_RGB__DM1, CYREG_PRT0_DM1
.set LED_RGB__DM2, CYREG_PRT0_DM2
.set LED_RGB__DR, CYREG_PRT0_DR
.set LED_RGB__INP_DIS, CYREG_PRT0_INP_DIS
.set LED_RGB__INTTYPE_BASE, CYDEV_PICU_INTTYPE_PICU0_BASE
.set LED_RGB__LCD_COM_SEG, CYREG_PRT0_LCD_COM_SEG
.set LED_RGB__LCD_EN, CYREG_PRT0_LCD_EN
.set LED_RGB__MASK, 0x70
.set LED_RGB__PORT, 0
.set LED_RGB__PRT, CYREG_PRT0_PRT
.set LED_RGB__PRTDSI__CAPS_SEL, CYREG_PRT0_CAPS_SEL
.set LED_RGB__PRTDSI__DBL_SYNC_IN, CYREG_PRT0_DBL_SYNC_IN
.set LED_RGB__PRTDSI__OE_SEL0, CYREG_PRT0_OE_SEL0
.set LED_RGB__PRTDSI__OE_SEL1, CYREG_PRT0_OE_SEL1
.set LED_RGB__PRTDSI__OUT_SEL0, CYREG_PRT0_OUT_SEL0
.set LED_RGB__PRTDSI__OUT_SEL1, CYREG_PRT0_OUT_SEL1
.set LED_RGB__PRTDSI__SYNC_OUT, CYREG_PRT0_SYNC_OUT
.set LED_RGB__PS, CYREG_PRT0_PS
.set LED_RGB__SHIFT, 4
.set LED_RGB__SLW, CYREG_PRT0_SLW

/* Pins_Port1 */
.set Pins_Port1__0__INTTYPE, CYREG_PICU2_INTTYPE1
.set Pins_Port1__0__MASK, 0x02
.set Pins_Port1__0__PC, CYREG_PRT2_PC1
.set Pins_Port1__0__PORT, 2
.set Pins_Port1__0__SHIFT, 1
.set Pins_Port1__1__INTTYPE, CYREG_PICU2_INTTYPE2
.set Pins_Port1__1__MASK, 0x04
.set Pins_Port1__1__PC, CYREG_PRT2_PC2
.set Pins_Port1__1__PORT, 2
.set Pins_Port1__1__SHIFT, 2
.set Pins_Port1__2__INTTYPE, CYREG_PICU2_INTTYPE3
.set Pins_Port1__2__MASK, 0x08
.set Pins_Port1__2__PC, CYREG_PRT2_PC3
.set Pins_Port1__2__PORT, 2
.set Pins_Port1__2__SHIFT, 3
.set Pins_Port1__AG, CYREG_PRT2_AG
.set Pins_Port1__AMUX, CYREG_PRT2_AMUX
.set Pins_Port1__BIE, CYREG_PRT2_BIE
.set Pins_Port1__BIT_MASK, CYREG_PRT2_BIT_MASK
.set Pins_Port1__BYP, CYREG_PRT2_BYP
.set Pins_Port1__CTL, CYREG_PRT2_CTL
.set Pins_Port1__DM0, CYREG_PRT2_DM0
.set Pins_Port1__DM1, CYREG_PRT2_DM1
.set Pins_Port1__DM2, CYREG_PRT2_DM2
.set Pins_Port1__DR, CYREG_PRT2_DR
.set Pins_Port1__INP_DIS, CYREG_PRT2_INP_DIS
.set Pins_Port1__INTSTAT, CYREG_PICU2_INTSTAT
.set Pins_Port1__INTTYPE_BASE, CYDEV_PICU_INTTYPE_PICU2_BASE
.set Pins_Port1__LCD_COM_SEG, CYREG_PRT2_LCD_COM_SEG
.set Pins_Port1__LCD_EN, CYREG_PRT2_LCD_EN
.set Pins_Port1__MASK, 0x0E
.set Pins_Port1__PORT, 2
.set Pins_Port1__PRT, CYREG_PRT2_PRT
.set Pins_Port1__PRTDSI__CAPS_SEL, CYREG_PRT2_CAPS_SEL
.set Pins_Port1__PRTDSI__DBL_SYNC_IN, CYREG_PRT2_DBL_SYNC_IN
.set Pins_Port1__PRTDSI__OE_SEL0, CYREG_PRT2_OE_SEL0
.set Pins_Port1__PRTDSI__OE_SEL1, CYREG_PRT2_OE_SEL1
.set Pins_Port1__PRTDSI__OUT_SEL0, CYREG_PRT2_OUT_SEL0
.set Pins_Port1__PRTDSI__OUT_SEL1, CYREG_PRT2_OUT_SEL1
.set Pins_Port1__PRTDSI__SYNC_OUT, CYREG_PRT2_SYNC_OUT
.set Pins_Port1__PS, CYREG_PRT2_PS
.set Pins_Port1__SHIFT, 1
.set Pins_Port1__SLW, CYREG_PRT2_SLW
.set Pins_Port1__SNAP, CYREG_PICU2_SNAP

/* Pins_Port2 */
.set Pins_Port2__0__INTTYPE, CYREG_PICU6_INTTYPE4
.set Pins_Port2__0__MASK, 0x10
.set Pins_Port2__0__PC, CYREG_PRT6_PC4
.set Pins_Port2__0__PORT, 6
.set Pins_Port2__0__SHIFT, 4
.set Pins_Port2__1__INTTYPE, CYREG_PICU6_INTTYPE5
.set Pins_Port2__1__MASK, 0x20
.set Pins_Port2__1__PC, CYREG_PRT6_PC5
.set Pins_Port2__1__PORT, 6
.set Pins_Port2__1__SHIFT, 5
.set Pins_Port2__2__INTTYPE, CYREG_PICU6_INTTYPE6
.set Pins_Port2__2__MASK, 0x40
.set Pins_Port2__2__PC, CYREG_PRT6_PC6
.set Pins_Port2__2__PORT, 6
.set Pins_Port2__2__SHIFT, 6
.set Pins_Port2__AG, CYREG_PRT6_AG
.set Pins_Port2__AMUX, CYREG_PRT6_AMUX
.set Pins_Port2__BIE, CYREG_PRT6_BIE
.set Pins_Port2__BIT_MASK, CYREG_PRT6_BIT_MASK
.set Pins_Port2__BYP, CYREG_PRT6_BYP
.set Pins_Port2__CTL, CYREG_PRT6_CTL
.set Pins_Port2__DM0, CYREG_PRT6_DM0
.set Pins_Port2__DM1, CYREG_PRT6_DM1
.set Pins_Port2__DM2, CYREG_PRT6_DM2
.set Pins_Port2__DR, CYREG_PRT6_DR
.set Pins_Port2__INP_DIS, CYREG_PRT6_INP_DIS
.set Pins_Port2__INTSTAT, CYREG_PICU6_INTSTAT
.set Pins_Port2__INTTYPE_BASE, CYDEV_PICU_INTTYPE_PICU6_BASE
.set Pins_Port2__LCD_COM_SEG, CYREG_PRT6_LCD_COM_SEG
.set Pins_Port2__LCD_EN, CYREG_PRT6_LCD_EN
.set Pins_Port2__MASK, 0x70
.set Pins_Port2__PORT, 6
.set Pins_Port2__PRT, CYREG_PRT6_PRT
.set Pins_Port2__PRTDSI__CAPS_SEL, CYREG_PRT6_CAPS_SEL
.set Pins_Port2__PRTDSI__DBL_SYNC_IN, CYREG_PRT6_DBL_SYNC_IN
.set Pins_Port2__PRTDSI__OE_SEL0, CYREG_PRT6_OE_SEL0
.set Pins_Port2__PRTDSI__OE_SEL1, CYREG_PRT6_OE_SEL1
.set Pins_Port2__PRTDSI__OUT_SEL0, CYREG_PRT6_OUT_SEL0
.set Pins_Port2__PRTDSI__OUT_SEL1, CYREG_PRT6_OUT_SEL1
.set Pins_Port2__PRTDSI__SYNC_OUT, CYREG_PRT6_SYNC_OUT
.set Pins_Port2__PS, CYREG_PRT6_PS
.set Pins_Port2__SHIFT, 4
.set Pins_Port2__SLW, CYREG_PRT6_SLW
.set Pins_Port2__SNAP, CYREG_PICU6_SNAP

/* UART_Debug */
.set UART_Debug_BUART_sRX_RxBitCounter__16BIT_CONTROL_AUX_CTL_REG, CYREG_B1_UDB04_05_ACTL
.set UART_Debug_BUART_sRX_RxBitCounter__16BIT_CONTROL_CONTROL_REG, CYREG_B1_UDB04_05_CTL
.set UART_Debug_BUART_sRX_RxBitCounter__16BIT_CONTROL_COUNT_REG, CYREG_B1_UDB04_05_CTL
.set UART_Debug_BUART_sRX_RxBitCounter__16BIT_COUNT_CONTROL_REG, CYREG_B1_UDB04_05_CTL
.set UART_Debug_BUART_sRX_RxBitCounter__16BIT_COUNT_COUNT_REG, CYREG_B1_UDB04_05_CTL
.set UART_Debug_BUART_sRX_RxBitCounter__16BIT_MASK_MASK_REG, CYREG_B1_UDB04_05_MSK
.set UART_Debug_BUART_sRX_RxBitCounter__16BIT_MASK_PERIOD_REG, CYREG_B1_UDB04_05_MSK
.set UART_Debug_BUART_sRX_RxBitCounter__16BIT_PERIOD_MASK_REG, CYREG_B1_UDB04_05_MSK
.set UART_Debug_BUART_sRX_RxBitCounter__16BIT_PERIOD_PERIOD_REG, CYREG_B1_UDB04_05_MSK
.set UART_Debug_BUART_sRX_RxBitCounter__CONTROL_AUX_CTL_REG, CYREG_B1_UDB04_ACTL
.set UART_Debug_BUART_sRX_RxBitCounter__CONTROL_REG, CYREG_B1_UDB04_CTL
.set UART_Debug_BUART_sRX_RxBitCounter__CONTROL_ST_REG, CYREG_B1_UDB04_ST_CTL
.set UART_Debug_BUART_sRX_RxBitCounter__COUNT_REG, CYREG_B1_UDB04_CTL
.set UART_Debug_BUART_sRX_RxBitCounter__COUNT_ST_REG, CYREG_B1_UDB04_ST_CTL
.set UART_Debug_BUART_sRX_RxBitCounter__MASK_CTL_AUX_CTL_REG, CYREG_B1_UDB04_MSK_ACTL
.set UART_Debug_BUART_sRX_RxBitCounter__PER_CTL_AUX_CTL_REG, CYREG_B1_UDB04_MSK_ACTL
.set UART_Debug_BUART_sRX_RxBitCounter__PERIOD_REG, CYREG_B1_UDB04_MSK
.set UART_Debug_BUART_sRX_RxBitCounter_ST__16BIT_STATUS_AUX_CTL_REG, CYREG_B1_UDB04_05_ACTL
.set UART_Debug_BUART_sRX_RxBitCounter_ST__16BIT_STATUS_REG, CYREG_B1_UDB04_05_ST
.set UART_Debug_BUART_sRX_RxBitCounter_ST__MASK_REG, CYREG_B1_UDB04_MSK
.set UART_Debug_BUART_sRX_RxBitCounter_ST__MASK_ST_AUX_CTL_REG, CYREG_B1_UDB04_MSK_ACTL
.set UART_Debug_BUART_sRX_RxBitCounter_ST__PER_ST_AUX_CTL_REG, CYREG_B1_UDB04_MSK_ACTL
.set UART_Debug_BUART_sRX_RxBitCounter_ST__STATUS_AUX_CTL_REG, CYREG_B1_UDB04_ACTL
.set UART_Debug_BUART_sRX_RxBitCounter_ST__STATUS_CNT_REG, CYREG_B1_UDB04_ST_CTL
.set UART_Debug_BUART_sRX_RxBitCounter_ST__STATUS_CONTROL_REG, CYREG_B1_UDB04_ST_CTL
.set UART_Debug_BUART_sRX_RxBitCounter_ST__STATUS_REG, CYREG_B1_UDB04_ST
.set UART_Debug_BUART_sRX_RxShifter_u0__16BIT_A0_REG, CYREG_B1_UDB04_05_A0
.set UART_Debug_BUART_sRX_RxShifter_u0__16BIT_A1_REG, CYREG_B1_UDB04_05_A1
.set UART_Debug_BUART_sRX_RxShifter_u0__16BIT_D0_REG, CYREG_B1_UDB04_05_D0
.set UART_Debug_BUART_sRX_RxShifter_u0__16BIT_D1_REG, CYREG_B1_UDB04_05_D1
.set UART_Debug_BUART_sRX_RxShifter_u0__16BIT_DP_AUX_CTL_REG, CYREG_B1_UDB04_05_ACTL
.set UART_Debug_BUART_sRX_RxShifter_u0__16BIT_F0_REG, CYREG_B1_UDB04_05_F0
.set UART_Debug_BUART_sRX_RxShifter_u0__16BIT_F1_REG, CYREG_B1_UDB04_05_F1
.set UART_Debug_BUART_sRX_RxShifter_u0__A0_A1_REG, CYREG_B1_UDB04_A0_A1
.set UART_Debug_BUART_sRX_RxShifter_u0__A0_REG, CYREG_B1_UDB04_A0
.set UART_Debug_BUART_sRX_RxShifter_u0__A1_REG, CYREG_B1_UDB04_A1
.set UART_Debug_BUART_sRX_RxShifter_u0__D0_D1_REG, CYREG_B1_UDB04_D0_D1
.set UART_Debug_BUART_sRX_RxShifter_u0__D0_REG, CYREG_B1_UDB04_D0
.set UART_Debug_BUART_sRX_RxShifter_u0__D1_REG, CYREG_B1_UDB04_D1
.set UART_Debug_BUART_sRX_RxShifter_u0__DP_AUX_CTL_REG, CYREG_B1_UDB04_ACTL
.set UART_Debug_BUART_sRX_RxShifter_u0__F0_F1_REG, CYREG_B1_UDB04_F0_F1
.set UART_Debug_BUART_sRX_RxShifter_u0__F0_REG, CYREG_B1_UDB04_F0
.set UART_Debug_BUART_sRX_RxShifter_u0__F1_REG, CYREG_B1_UDB04_F1
.set UART_Debug_BUART_sRX_RxShifter_u0__MSK_DP_AUX_CTL_REG, CYREG_B1_UDB04_MSK_ACTL
.set UART_Debug_BUART_sRX_RxShifter_u0__PER_DP_AUX_CTL_REG, CYREG_B1_UDB04_MSK_ACTL
.set UART_Debug_BUART_sRX_RxSts__16BIT_STATUS_AUX_CTL_REG, CYREG_B1_UDB07_08_ACTL
.set UART_Debug_BUART_sRX_RxSts__16BIT_STATUS_REG, CYREG_B1_UDB07_08_ST
.set UART_Debug_BUART_sRX_RxSts__3__MASK, 0x08
.set UART_Debug_BUART_sRX_RxSts__3__POS, 3
.set UART_Debug_BUART_sRX_RxSts__4__MASK, 0x10
.set UART_Debug_BUART_sRX_RxSts__4__POS, 4
.set UART_Debug_BUART_sRX_RxSts__5__MASK, 0x20
.set UART_Debug_BUART_sRX_RxSts__5__POS, 5
.set UART_Debug_BUART_sRX_RxSts__MASK, 0x38
.set UART_Debug_BUART_sRX_RxSts__MASK_REG, CYREG_B1_UDB07_MSK
.set UART_Debug_BUART_sRX_RxSts__STATUS_AUX_CTL_REG, CYREG_B1_UDB07_ACTL
.set UART_Debug_BUART_sRX_RxSts__STATUS_REG, CYREG_B1_UDB07_ST
.set UART_Debug_BUART_sTX_sCLOCK_TxBitClkGen__16BIT_A0_REG, CYREG_B1_UDB07_08_A0
.set UART_Debug_BUART_sTX_sCLOCK_TxBitClkGen__16BIT_A1_REG, CYREG_B1_UDB07_08_A1
.set UART_Debug_BUART_sTX_sCLOCK_TxBitClkGen__16BIT_D0_REG, CYREG_B1_UDB07_08_D0
.set UART_Debug_BUART_sTX_sCLOCK_TxBitClkGen__16BIT_D1_REG, CYREG_B1_UDB07_08_D1
.set UART_Debug_BUART_sTX_sCLOCK_TxBitClkGen__16BIT_DP_AUX_CTL_REG, CYREG_B1_UDB07_08_ACTL
.set UART_Debug_BUART_sTX_sCLOCK_TxBitClkGen__16BIT_F0_REG, CYREG_B1_UDB07_08_F0
.set UART_Debug_BUART_sTX_sCLOCK_TxBitClkGen__16BIT_F1_REG, CYREG_B1_UDB07_08_F1
.set UART_Debug_BUART_sTX_sCLOCK_TxBitClkGen__A0_A1_REG, CYREG_B1_UDB07_A0_A1
.set UART_Debug_BUART_sTX_sCLOCK_TxBitClkGen__A0_REG, CYREG_B1_UDB07_A0
.set UART_Debug_BUART_sTX_sCLOCK_TxBitClkGen__A1_REG, CYREG_B1_UDB07_A1
.set UART_Debug_BUART_sTX_sCLOCK_TxBitClkGen__D0_D1_REG, CYREG_B1_UDB07_D0_D1
.set UART_Debug_BUART_sTX_sCLOCK_TxBitClkGen__D0_REG, CYREG_B1_UDB07_D0
.set UART_Debug_BUART_sTX_sCLOCK_TxBitClkGen__D1_REG, CYREG_B1_UDB07_D1
.set UART_Debug_BUART_sTX_sCLOCK_TxBitClkGen__DP_AUX_CTL_REG, CYREG_B1_UDB07_ACTL
.set UART_Debug_BUART_sTX_sCLOCK_TxBitClkGen__F0_F1_REG, CYREG_B1_UDB07_F0_F1
.set UART_Debug_BUART_sTX_sCLOCK_TxBitClkGen__F0_REG, CYREG_B1_UDB07_F0
.set UART_Debug_BUART_sTX_sCLOCK_TxBitClkGen__F1_REG, CYREG_B1_UDB07_F1
.set UART_Debug_BUART_sTX_TxShifter_u0__16BIT_A0_REG, CYREG_B0_UDB07_08_A0
.set UART_Debug_BUART_sTX_TxShifter_u0__16BIT_A1_REG, CYREG_B0_UDB07_08_A1
.set UART_Debug_BUART_sTX_TxShifter_u0__16BIT_D0_REG, CYREG_B0_UDB07_08_D0
.set UART_Debug_BUART_sTX_TxShifter_u0__16BIT_D1_REG, CYREG_B0_UDB07_08_D1
.set UART_Debug_BUART_sTX_TxShifter_u0__16BIT_DP_AUX_CTL_REG, CYREG_B0_UDB07_08_ACTL
.set UART_Debug_BUART_sTX_TxShifter_u0__16BIT_F0_REG, CYREG_B0_UDB07_08_F0
.set UART_Debug_BUART_sTX_TxShifter_u0__16BIT_F1_REG, CYREG_B0_UDB07_08_F1
.set UART_Debug_BUART_sTX_TxShifter_u0__A0_A1_REG, CYREG_B0_UDB07_A0_A1
.set UART_Debug_BUART_sTX_TxShifter_u0__A0_REG, CYREG_B0_UDB07_A0
.set UART_Debug_BUART_sTX_TxShifter_u0__A1_REG, CYREG_B0_UDB07_A1
.set UART_Debug_BUART_sTX_TxShifter_u0__D0_D1_REG, CYREG_B0_UDB07_D0_D1
.set UART_Debug_BUART_sTX_TxShifter_u0__D0_REG, CYREG_B0_UDB07_D0
.set UART_Debug_BUART_sTX_TxShifter_u0__D1_REG, CYREG_B0_UDB07_D1
.set UART_Debug_BUART_sTX_TxShifter_u0__DP_AUX_CTL_REG, CYREG_B0_UDB07_ACTL
.set UART_Debug_BUART_sTX_TxShifter_u0__F0_F1_REG, CYREG_B0_UDB07_F0_F1
.set UART_Debug_BUART_sTX_TxShifter_u0__F0_REG, CYREG_B0_UDB07_F0
.set UART_Debug_BUART_sTX_TxShifter_u0__F1_REG, CYREG_B0_UDB07_F1
.set UART_Debug_BUART_sTX_TxSts__0__MASK, 0x01
.set UART_Debug_BUART_sTX_TxSts__0__POS, 0
.set UART_Debug_BUART_sTX_TxSts__1__MASK, 0x02
.set UART_Debug_BUART_sTX_TxSts__1__POS, 1
.set UART_Debug_BUART_sTX_TxSts__16BIT_STATUS_AUX_CTL_REG, CYREG_B0_UDB07_08_ACTL
.set UART_Debug_BUART_sTX_TxSts__16BIT_STATUS_REG, CYREG_B0_UDB07_08_ST
.set UART_Debug_BUART_sTX_TxSts__2__MASK, 0x04
.set UART_Debug_BUART_sTX_TxSts__2__POS, 2
.set UART_Debug_BUART_sTX_TxSts__3__MASK, 0x08
.set UART_Debug_BUART_sTX_TxSts__3__POS, 3
.set UART_Debug_BUART_sTX_TxSts__MASK, 0x0F
.set UART_Debug_BUART_sTX_TxSts__MASK_REG, CYREG_B0_UDB07_MSK
.set UART_Debug_BUART_sTX_TxSts__STATUS_AUX_CTL_REG, CYREG_B0_UDB07_ACTL
.set UART_Debug_BUART_sTX_TxSts__STATUS_REG, CYREG_B0_UDB07_ST
.set UART_Debug_IntClock__CFG0, CYREG_CLKDIST_DCFG1_CFG0
.set UART_Debug_IntClock__CFG1, CYREG_CLKDIST_DCFG1_CFG1
.set UART_Debug_IntClock__CFG2, CYREG_CLKDIST_DCFG1_CFG2
.set UART_Debug_IntClock__CFG2_SRC_SEL_MASK, 0x07
.set UART_Debug_IntClock__INDEX, 0x01
.set UART_Debug_IntClock__PM_ACT_CFG, CYREG_PM_ACT_CFG2
.set UART_Debug_IntClock__PM_ACT_MSK, 0x02
.set UART_Debug_IntClock__PM_STBY_CFG, CYREG_PM_STBY_CFG2
.set UART_Debug_IntClock__PM_STBY_MSK, 0x02
.set UART_Debug_RXInternalInterrupt__INTC_CLR_EN_REG, CYREG_NVIC_CLRENA0
.set UART_Debug_RXInternalInterrupt__INTC_CLR_PD_REG, CYREG_NVIC_CLRPEND0
.set UART_Debug_RXInternalInterrupt__INTC_MASK, 0x01
.set UART_Debug_RXInternalInterrupt__INTC_NUMBER, 0
.set UART_Debug_RXInternalInterrupt__INTC_PRIOR_NUM, 7
.set UART_Debug_RXInternalInterrupt__INTC_PRIOR_REG, CYREG_NVIC_PRI_0
.set UART_Debug_RXInternalInterrupt__INTC_SET_EN_REG, CYREG_NVIC_SETENA0
.set UART_Debug_RXInternalInterrupt__INTC_SET_PD_REG, CYREG_NVIC_SETPEND0
.set UART_Debug_TXInternalInterrupt__INTC_CLR_EN_REG, CYREG_NVIC_CLRENA0
.set UART_Debug_TXInternalInterrupt__INTC_CLR_PD_REG, CYREG_NVIC_CLRPEND0
.set UART_Debug_TXInternalInterrupt__INTC_MASK, 0x02
.set UART_Debug_TXInternalInterrupt__INTC_NUMBER, 1
.set UART_Debug_TXInternalInterrupt__INTC_PRIOR_NUM, 7
.set UART_Debug_TXInternalInterrupt__INTC_PRIOR_REG, CYREG_NVIC_PRI_1
.set UART_Debug_TXInternalInterrupt__INTC_SET_EN_REG, CYREG_NVIC_SETENA0
.set UART_Debug_TXInternalInterrupt__INTC_SET_PD_REG, CYREG_NVIC_SETPEND0

/* UART_Linux */
.set UART_Linux_BUART_sRX_RxBitCounter__16BIT_CONTROL_AUX_CTL_REG, CYREG_B0_UDB02_03_ACTL
.set UART_Linux_BUART_sRX_RxBitCounter__16BIT_CONTROL_CONTROL_REG, CYREG_B0_UDB02_03_CTL
.set UART_Linux_BUART_sRX_RxBitCounter__16BIT_CONTROL_COUNT_REG, CYREG_B0_UDB02_03_CTL
.set UART_Linux_BUART_sRX_RxBitCounter__16BIT_COUNT_CONTROL_REG, CYREG_B0_UDB02_03_CTL
.set UART_Linux_BUART_sRX_RxBitCounter__16BIT_COUNT_COUNT_REG, CYREG_B0_UDB02_03_CTL
.set UART_Linux_BUART_sRX_RxBitCounter__16BIT_MASK_MASK_REG, CYREG_B0_UDB02_03_MSK
.set UART_Linux_BUART_sRX_RxBitCounter__16BIT_MASK_PERIOD_REG, CYREG_B0_UDB02_03_MSK
.set UART_Linux_BUART_sRX_RxBitCounter__16BIT_PERIOD_MASK_REG, CYREG_B0_UDB02_03_MSK
.set UART_Linux_BUART_sRX_RxBitCounter__16BIT_PERIOD_PERIOD_REG, CYREG_B0_UDB02_03_MSK
.set UART_Linux_BUART_sRX_RxBitCounter__CONTROL_AUX_CTL_REG, CYREG_B0_UDB02_ACTL
.set UART_Linux_BUART_sRX_RxBitCounter__CONTROL_REG, CYREG_B0_UDB02_CTL
.set UART_Linux_BUART_sRX_RxBitCounter__CONTROL_ST_REG, CYREG_B0_UDB02_ST_CTL
.set UART_Linux_BUART_sRX_RxBitCounter__COUNT_REG, CYREG_B0_UDB02_CTL
.set UART_Linux_BUART_sRX_RxBitCounter__COUNT_ST_REG, CYREG_B0_UDB02_ST_CTL
.set UART_Linux_BUART_sRX_RxBitCounter__MASK_CTL_AUX_CTL_REG, CYREG_B0_UDB02_MSK_ACTL
.set UART_Linux_BUART_sRX_RxBitCounter__PER_CTL_AUX_CTL_REG, CYREG_B0_UDB02_MSK_ACTL
.set UART_Linux_BUART_sRX_RxBitCounter__PERIOD_REG, CYREG_B0_UDB02_MSK
.set UART_Linux_BUART_sRX_RxBitCounter_ST__16BIT_STATUS_AUX_CTL_REG, CYREG_B0_UDB02_03_ACTL
.set UART_Linux_BUART_sRX_RxBitCounter_ST__16BIT_STATUS_REG, CYREG_B0_UDB02_03_ST
.set UART_Linux_BUART_sRX_RxBitCounter_ST__MASK_REG, CYREG_B0_UDB02_MSK
.set UART_Linux_BUART_sRX_RxBitCounter_ST__MASK_ST_AUX_CTL_REG, CYREG_B0_UDB02_MSK_ACTL
.set UART_Linux_BUART_sRX_RxBitCounter_ST__PER_ST_AUX_CTL_REG, CYREG_B0_UDB02_MSK_ACTL
.set UART_Linux_BUART_sRX_RxBitCounter_ST__STATUS_AUX_CTL_REG, CYREG_B0_UDB02_ACTL
.set UART_Linux_BUART_sRX_RxBitCounter_ST__STATUS_CNT_REG, CYREG_B0_UDB02_ST_CTL
.set UART_Linux_BUART_sRX_RxBitCounter_ST__STATUS_CONTROL_REG, CYREG_B0_UDB02_ST_CTL
.set UART_Linux_BUART_sRX_RxBitCounter_ST__STATUS_REG, CYREG_B0_UDB02_ST
.set UART_Linux_BUART_sRX_RxShifter_u0__16BIT_A0_REG, CYREG_B0_UDB05_06_A0
.set UART_Linux_BUART_sRX_RxShifter_u0__16BIT_A1_REG, CYREG_B0_UDB05_06_A1
.set UART_Linux_BUART_sRX_RxShifter_u0__16BIT_D0_REG, CYREG_B0_UDB05_06_D0
.set UART_Linux_BUART_sRX_RxShifter_u0__16BIT_D1_REG, CYREG_B0_UDB05_06_D1
.set UART_Linux_BUART_sRX_RxShifter_u0__16BIT_DP_AUX_CTL_REG, CYREG_B0_UDB05_06_ACTL
.set UART_Linux_BUART_sRX_RxShifter_u0__16BIT_F0_REG, CYREG_B0_UDB05_06_F0
.set UART_Linux_BUART_sRX_RxShifter_u0__16BIT_F1_REG, CYREG_B0_UDB05_06_F1
.set UART_Linux_BUART_sRX_RxShifter_u0__A0_A1_REG, CYREG_B0_UDB05_A0_A1
.set UART_Linux_BUART_sRX_RxShifter_u0__A0_REG, CYREG_B0_UDB05_A0
.set UART_Linux_BUART_sRX_RxShifter_u0__A1_REG, CYREG_B0_UDB05_A1
.set UART_Linux_BUART_sRX_RxShifter_u0__D0_D1_REG, CYREG_B0_UDB05_D0_D1
.set UART_Linux_BUART_sRX_RxShifter_u0__D0_REG, CYREG_B0_UDB05_D0
.set UART_Linux_BUART_sRX_RxShifter_u0__D1_REG, CYREG_B0_UDB05_D1
.set UART_Linux_BUART_sRX_RxShifter_u0__DP_AUX_CTL_REG, CYREG_B0_UDB05_ACTL
.set UART_Linux_BUART_sRX_RxShifter_u0__F0_F1_REG, CYREG_B0_UDB05_F0_F1
.set UART_Linux_BUART_sRX_RxShifter_u0__F0_REG, CYREG_B0_UDB05_F0
.set UART_Linux_BUART_sRX_RxShifter_u0__F1_REG, CYREG_B0_UDB05_F1
.set UART_Linux_BUART_sRX_RxSts__16BIT_STATUS_AUX_CTL_REG, CYREG_B0_UDB05_06_ACTL
.set UART_Linux_BUART_sRX_RxSts__16BIT_STATUS_REG, CYREG_B0_UDB05_06_ST
.set UART_Linux_BUART_sRX_RxSts__3__MASK, 0x08
.set UART_Linux_BUART_sRX_RxSts__3__POS, 3
.set UART_Linux_BUART_sRX_RxSts__4__MASK, 0x10
.set UART_Linux_BUART_sRX_RxSts__4__POS, 4
.set UART_Linux_BUART_sRX_RxSts__5__MASK, 0x20
.set UART_Linux_BUART_sRX_RxSts__5__POS, 5
.set UART_Linux_BUART_sRX_RxSts__MASK, 0x38
.set UART_Linux_BUART_sRX_RxSts__MASK_REG, CYREG_B0_UDB05_MSK
.set UART_Linux_BUART_sRX_RxSts__STATUS_AUX_CTL_REG, CYREG_B0_UDB05_ACTL
.set UART_Linux_BUART_sRX_RxSts__STATUS_REG, CYREG_B0_UDB05_ST
.set UART_Linux_BUART_sTX_sCLOCK_TxBitClkGen__16BIT_A0_REG, CYREG_B0_UDB06_07_A0
.set UART_Linux_BUART_sTX_sCLOCK_TxBitClkGen__16BIT_A1_REG, CYREG_B0_UDB06_07_A1
.set UART_Linux_BUART_sTX_sCLOCK_TxBitClkGen__16BIT_D0_REG, CYREG_B0_UDB06_07_D0
.set UART_Linux_BUART_sTX_sCLOCK_TxBitClkGen__16BIT_D1_REG, CYREG_B0_UDB06_07_D1
.set UART_Linux_BUART_sTX_sCLOCK_TxBitClkGen__16BIT_DP_AUX_CTL_REG, CYREG_B0_UDB06_07_ACTL
.set UART_Linux_BUART_sTX_sCLOCK_TxBitClkGen__16BIT_F0_REG, CYREG_B0_UDB06_07_F0
.set UART_Linux_BUART_sTX_sCLOCK_TxBitClkGen__16BIT_F1_REG, CYREG_B0_UDB06_07_F1
.set UART_Linux_BUART_sTX_sCLOCK_TxBitClkGen__A0_A1_REG, CYREG_B0_UDB06_A0_A1
.set UART_Linux_BUART_sTX_sCLOCK_TxBitClkGen__A0_REG, CYREG_B0_UDB06_A0
.set UART_Linux_BUART_sTX_sCLOCK_TxBitClkGen__A1_REG, CYREG_B0_UDB06_A1
.set UART_Linux_BUART_sTX_sCLOCK_TxBitClkGen__D0_D1_REG, CYREG_B0_UDB06_D0_D1
.set UART_Linux_BUART_sTX_sCLOCK_TxBitClkGen__D0_REG, CYREG_B0_UDB06_D0
.set UART_Linux_BUART_sTX_sCLOCK_TxBitClkGen__D1_REG, CYREG_B0_UDB06_D1
.set UART_Linux_BUART_sTX_sCLOCK_TxBitClkGen__DP_AUX_CTL_REG, CYREG_B0_UDB06_ACTL
.set UART_Linux_BUART_sTX_sCLOCK_TxBitClkGen__F0_F1_REG, CYREG_B0_UDB06_F0_F1
.set UART_Linux_BUART_sTX_sCLOCK_TxBitClkGen__F0_REG, CYREG_B0_UDB06_F0
.set UART_Linux_BUART_sTX_sCLOCK_TxBitClkGen__F1_REG, CYREG_B0_UDB06_F1
.set UART_Linux_BUART_sTX_TxShifter_u0__16BIT_A0_REG, CYREG_B1_UDB06_07_A0
.set UART_Linux_BUART_sTX_TxShifter_u0__16BIT_A1_REG, CYREG_B1_UDB06_07_A1
.set UART_Linux_BUART_sTX_TxShifter_u0__16BIT_D0_REG, CYREG_B1_UDB06_07_D0
.set UART_Linux_BUART_sTX_TxShifter_u0__16BIT_D1_REG, CYREG_B1_UDB06_07_D1
.set UART_Linux_BUART_sTX_TxShifter_u0__16BIT_DP_AUX_CTL_REG, CYREG_B1_UDB06_07_ACTL
.set UART_Linux_BUART_sTX_TxShifter_u0__16BIT_F0_REG, CYREG_B1_UDB06_07_F0
.set UART_Linux_BUART_sTX_TxShifter_u0__16BIT_F1_REG, CYREG_B1_UDB06_07_F1
.set UART_Linux_BUART_sTX_TxShifter_u0__A0_A1_REG, CYREG_B1_UDB06_A0_A1
.set UART_Linux_BUART_sTX_TxShifter_u0__A0_REG, CYREG_B1_UDB06_A0
.set UART_Linux_BUART_sTX_TxShifter_u0__A1_REG, CYREG_B1_UDB06_A1
.set UART_Linux_BUART_sTX_TxShifter_u0__D0_D1_REG, CYREG_B1_UDB06_D0_D1
.set UART_Linux_BUART_sTX_TxShifter_u0__D0_REG, CYREG_B1_UDB06_D0
.set UART_Linux_BUART_sTX_TxShifter_u0__D1_REG, CYREG_B1_UDB06_D1
.set UART_Linux_BUART_sTX_TxShifter_u0__DP_AUX_CTL_REG, CYREG_B1_UDB06_ACTL
.set UART_Linux_BUART_sTX_TxShifter_u0__F0_F1_REG, CYREG_B1_UDB06_F0_F1
.set UART_Linux_BUART_sTX_TxShifter_u0__F0_REG, CYREG_B1_UDB06_F0
.set UART_Linux_BUART_sTX_TxShifter_u0__F1_REG, CYREG_B1_UDB06_F1
.set UART_Linux_BUART_sTX_TxSts__0__MASK, 0x01
.set UART_Linux_BUART_sTX_TxSts__0__POS, 0
.set UART_Linux_BUART_sTX_TxSts__1__MASK, 0x02
.set UART_Linux_BUART_sTX_TxSts__1__POS, 1
.set UART_Linux_BUART_sTX_TxSts__16BIT_STATUS_AUX_CTL_REG, CYREG_B1_UDB06_07_ACTL
.set UART_Linux_BUART_sTX_TxSts__16BIT_STATUS_REG, CYREG_B1_UDB06_07_ST
.set UART_Linux_BUART_sTX_TxSts__2__MASK, 0x04
.set UART_Linux_BUART_sTX_TxSts__2__POS, 2
.set UART_Linux_BUART_sTX_TxSts__3__MASK, 0x08
.set UART_Linux_BUART_sTX_TxSts__3__POS, 3
.set UART_Linux_BUART_sTX_TxSts__MASK, 0x0F
.set UART_Linux_BUART_sTX_TxSts__MASK_REG, CYREG_B1_UDB06_MSK
.set UART_Linux_BUART_sTX_TxSts__STATUS_AUX_CTL_REG, CYREG_B1_UDB06_ACTL
.set UART_Linux_BUART_sTX_TxSts__STATUS_REG, CYREG_B1_UDB06_ST
.set UART_Linux_IntClock__CFG0, CYREG_CLKDIST_DCFG0_CFG0
.set UART_Linux_IntClock__CFG1, CYREG_CLKDIST_DCFG0_CFG1
.set UART_Linux_IntClock__CFG2, CYREG_CLKDIST_DCFG0_CFG2
.set UART_Linux_IntClock__CFG2_SRC_SEL_MASK, 0x07
.set UART_Linux_IntClock__INDEX, 0x00
.set UART_Linux_IntClock__PM_ACT_CFG, CYREG_PM_ACT_CFG2
.set UART_Linux_IntClock__PM_ACT_MSK, 0x01
.set UART_Linux_IntClock__PM_STBY_CFG, CYREG_PM_STBY_CFG2
.set UART_Linux_IntClock__PM_STBY_MSK, 0x01
.set UART_Linux_RXInternalInterrupt__INTC_CLR_EN_REG, CYREG_NVIC_CLRENA0
.set UART_Linux_RXInternalInterrupt__INTC_CLR_PD_REG, CYREG_NVIC_CLRPEND0
.set UART_Linux_RXInternalInterrupt__INTC_MASK, 0x04
.set UART_Linux_RXInternalInterrupt__INTC_NUMBER, 2
.set UART_Linux_RXInternalInterrupt__INTC_PRIOR_NUM, 2
.set UART_Linux_RXInternalInterrupt__INTC_PRIOR_REG, CYREG_NVIC_PRI_2
.set UART_Linux_RXInternalInterrupt__INTC_SET_EN_REG, CYREG_NVIC_SETENA0
.set UART_Linux_RXInternalInterrupt__INTC_SET_PD_REG, CYREG_NVIC_SETPEND0
.set UART_Linux_TXInternalInterrupt__INTC_CLR_EN_REG, CYREG_NVIC_CLRENA0
.set UART_Linux_TXInternalInterrupt__INTC_CLR_PD_REG, CYREG_NVIC_CLRPEND0
.set UART_Linux_TXInternalInterrupt__INTC_MASK, 0x08
.set UART_Linux_TXInternalInterrupt__INTC_NUMBER, 3
.set UART_Linux_TXInternalInterrupt__INTC_PRIOR_NUM, 7
.set UART_Linux_TXInternalInterrupt__INTC_PRIOR_REG, CYREG_NVIC_PRI_3
.set UART_Linux_TXInternalInterrupt__INTC_SET_EN_REG, CYREG_NVIC_SETENA0
.set UART_Linux_TXInternalInterrupt__INTC_SET_PD_REG, CYREG_NVIC_SETPEND0

/* intr_Port1 */
.set intr_Port1__INTC_CLR_EN_REG, CYREG_NVIC_CLRENA0
.set intr_Port1__INTC_CLR_PD_REG, CYREG_NVIC_CLRPEND0
.set intr_Port1__INTC_MASK, 0x40
.set intr_Port1__INTC_NUMBER, 6
.set intr_Port1__INTC_PRIOR_NUM, 0
.set intr_Port1__INTC_PRIOR_REG, CYREG_NVIC_PRI_6
.set intr_Port1__INTC_SET_EN_REG, CYREG_NVIC_SETENA0
.set intr_Port1__INTC_SET_PD_REG, CYREG_NVIC_SETPEND0

/* intr_Port2 */
.set intr_Port2__INTC_CLR_EN_REG, CYREG_NVIC_CLRENA0
.set intr_Port2__INTC_CLR_PD_REG, CYREG_NVIC_CLRPEND0
.set intr_Port2__INTC_MASK, 0x400
.set intr_Port2__INTC_NUMBER, 10
.set intr_Port2__INTC_PRIOR_NUM, 1
.set intr_Port2__INTC_PRIOR_REG, CYREG_NVIC_PRI_10
.set intr_Port2__INTC_SET_EN_REG, CYREG_NVIC_SETENA0
.set intr_Port2__INTC_SET_PD_REG, CYREG_NVIC_SETPEND0

/* Relay_Port1 */
.set Relay_Port1__0__INTTYPE, CYREG_PICU2_INTTYPE6
.set Relay_Port1__0__MASK, 0x40
.set Relay_Port1__0__PC, CYREG_PRT2_PC6
.set Relay_Port1__0__PORT, 2
.set Relay_Port1__0__SHIFT, 6
.set Relay_Port1__AG, CYREG_PRT2_AG
.set Relay_Port1__AMUX, CYREG_PRT2_AMUX
.set Relay_Port1__BIE, CYREG_PRT2_BIE
.set Relay_Port1__BIT_MASK, CYREG_PRT2_BIT_MASK
.set Relay_Port1__BYP, CYREG_PRT2_BYP
.set Relay_Port1__CTL, CYREG_PRT2_CTL
.set Relay_Port1__DM0, CYREG_PRT2_DM0
.set Relay_Port1__DM1, CYREG_PRT2_DM1
.set Relay_Port1__DM2, CYREG_PRT2_DM2
.set Relay_Port1__DR, CYREG_PRT2_DR
.set Relay_Port1__INP_DIS, CYREG_PRT2_INP_DIS
.set Relay_Port1__INTTYPE_BASE, CYDEV_PICU_INTTYPE_PICU2_BASE
.set Relay_Port1__LCD_COM_SEG, CYREG_PRT2_LCD_COM_SEG
.set Relay_Port1__LCD_EN, CYREG_PRT2_LCD_EN
.set Relay_Port1__MASK, 0x40
.set Relay_Port1__PORT, 2
.set Relay_Port1__PRT, CYREG_PRT2_PRT
.set Relay_Port1__PRTDSI__CAPS_SEL, CYREG_PRT2_CAPS_SEL
.set Relay_Port1__PRTDSI__DBL_SYNC_IN, CYREG_PRT2_DBL_SYNC_IN
.set Relay_Port1__PRTDSI__OE_SEL0, CYREG_PRT2_OE_SEL0
.set Relay_Port1__PRTDSI__OE_SEL1, CYREG_PRT2_OE_SEL1
.set Relay_Port1__PRTDSI__OUT_SEL0, CYREG_PRT2_OUT_SEL0
.set Relay_Port1__PRTDSI__OUT_SEL1, CYREG_PRT2_OUT_SEL1
.set Relay_Port1__PRTDSI__SYNC_OUT, CYREG_PRT2_SYNC_OUT
.set Relay_Port1__PS, CYREG_PRT2_PS
.set Relay_Port1__SHIFT, 6
.set Relay_Port1__SLW, CYREG_PRT2_SLW

/* Relay_Port2 */
.set Relay_Port2__0__INTTYPE, CYREG_PICU5_INTTYPE0
.set Relay_Port2__0__MASK, 0x01
.set Relay_Port2__0__PC, CYREG_PRT5_PC0
.set Relay_Port2__0__PORT, 5
.set Relay_Port2__0__SHIFT, 0
.set Relay_Port2__AG, CYREG_PRT5_AG
.set Relay_Port2__AMUX, CYREG_PRT5_AMUX
.set Relay_Port2__BIE, CYREG_PRT5_BIE
.set Relay_Port2__BIT_MASK, CYREG_PRT5_BIT_MASK
.set Relay_Port2__BYP, CYREG_PRT5_BYP
.set Relay_Port2__CTL, CYREG_PRT5_CTL
.set Relay_Port2__DM0, CYREG_PRT5_DM0
.set Relay_Port2__DM1, CYREG_PRT5_DM1
.set Relay_Port2__DM2, CYREG_PRT5_DM2
.set Relay_Port2__DR, CYREG_PRT5_DR
.set Relay_Port2__INP_DIS, CYREG_PRT5_INP_DIS
.set Relay_Port2__INTTYPE_BASE, CYDEV_PICU_INTTYPE_PICU5_BASE
.set Relay_Port2__LCD_COM_SEG, CYREG_PRT5_LCD_COM_SEG
.set Relay_Port2__LCD_EN, CYREG_PRT5_LCD_EN
.set Relay_Port2__MASK, 0x01
.set Relay_Port2__PORT, 5
.set Relay_Port2__PRT, CYREG_PRT5_PRT
.set Relay_Port2__PRTDSI__CAPS_SEL, CYREG_PRT5_CAPS_SEL
.set Relay_Port2__PRTDSI__DBL_SYNC_IN, CYREG_PRT5_DBL_SYNC_IN
.set Relay_Port2__PRTDSI__OE_SEL0, CYREG_PRT5_OE_SEL0
.set Relay_Port2__PRTDSI__OE_SEL1, CYREG_PRT5_OE_SEL1
.set Relay_Port2__PRTDSI__OUT_SEL0, CYREG_PRT5_OUT_SEL0
.set Relay_Port2__PRTDSI__OUT_SEL1, CYREG_PRT5_OUT_SEL1
.set Relay_Port2__PRTDSI__SYNC_OUT, CYREG_PRT5_SYNC_OUT
.set Relay_Port2__PS, CYREG_PRT5_PS
.set Relay_Port2__SHIFT, 0
.set Relay_Port2__SLW, CYREG_PRT5_SLW

/* Rx_UART_Linux */
.set Rx_UART_Linux__0__INTTYPE, CYREG_PICU3_INTTYPE1
.set Rx_UART_Linux__0__MASK, 0x02
.set Rx_UART_Linux__0__PC, CYREG_PRT3_PC1
.set Rx_UART_Linux__0__PORT, 3
.set Rx_UART_Linux__0__SHIFT, 1
.set Rx_UART_Linux__AG, CYREG_PRT3_AG
.set Rx_UART_Linux__AMUX, CYREG_PRT3_AMUX
.set Rx_UART_Linux__BIE, CYREG_PRT3_BIE
.set Rx_UART_Linux__BIT_MASK, CYREG_PRT3_BIT_MASK
.set Rx_UART_Linux__BYP, CYREG_PRT3_BYP
.set Rx_UART_Linux__CTL, CYREG_PRT3_CTL
.set Rx_UART_Linux__DM0, CYREG_PRT3_DM0
.set Rx_UART_Linux__DM1, CYREG_PRT3_DM1
.set Rx_UART_Linux__DM2, CYREG_PRT3_DM2
.set Rx_UART_Linux__DR, CYREG_PRT3_DR
.set Rx_UART_Linux__INP_DIS, CYREG_PRT3_INP_DIS
.set Rx_UART_Linux__INTTYPE_BASE, CYDEV_PICU_INTTYPE_PICU3_BASE
.set Rx_UART_Linux__LCD_COM_SEG, CYREG_PRT3_LCD_COM_SEG
.set Rx_UART_Linux__LCD_EN, CYREG_PRT3_LCD_EN
.set Rx_UART_Linux__MASK, 0x02
.set Rx_UART_Linux__PORT, 3
.set Rx_UART_Linux__PRT, CYREG_PRT3_PRT
.set Rx_UART_Linux__PRTDSI__CAPS_SEL, CYREG_PRT3_CAPS_SEL
.set Rx_UART_Linux__PRTDSI__DBL_SYNC_IN, CYREG_PRT3_DBL_SYNC_IN
.set Rx_UART_Linux__PRTDSI__OE_SEL0, CYREG_PRT3_OE_SEL0
.set Rx_UART_Linux__PRTDSI__OE_SEL1, CYREG_PRT3_OE_SEL1
.set Rx_UART_Linux__PRTDSI__OUT_SEL0, CYREG_PRT3_OUT_SEL0
.set Rx_UART_Linux__PRTDSI__OUT_SEL1, CYREG_PRT3_OUT_SEL1
.set Rx_UART_Linux__PRTDSI__SYNC_OUT, CYREG_PRT3_SYNC_OUT
.set Rx_UART_Linux__PS, CYREG_PRT3_PS
.set Rx_UART_Linux__SHIFT, 1
.set Rx_UART_Linux__SLW, CYREG_PRT3_SLW

/* Tx_UART_Linux */
.set Tx_UART_Linux__0__INTTYPE, CYREG_PICU3_INTTYPE0
.set Tx_UART_Linux__0__MASK, 0x01
.set Tx_UART_Linux__0__PC, CYREG_PRT3_PC0
.set Tx_UART_Linux__0__PORT, 3
.set Tx_UART_Linux__0__SHIFT, 0
.set Tx_UART_Linux__AG, CYREG_PRT3_AG
.set Tx_UART_Linux__AMUX, CYREG_PRT3_AMUX
.set Tx_UART_Linux__BIE, CYREG_PRT3_BIE
.set Tx_UART_Linux__BIT_MASK, CYREG_PRT3_BIT_MASK
.set Tx_UART_Linux__BYP, CYREG_PRT3_BYP
.set Tx_UART_Linux__CTL, CYREG_PRT3_CTL
.set Tx_UART_Linux__DM0, CYREG_PRT3_DM0
.set Tx_UART_Linux__DM1, CYREG_PRT3_DM1
.set Tx_UART_Linux__DM2, CYREG_PRT3_DM2
.set Tx_UART_Linux__DR, CYREG_PRT3_DR
.set Tx_UART_Linux__INP_DIS, CYREG_PRT3_INP_DIS
.set Tx_UART_Linux__INTTYPE_BASE, CYDEV_PICU_INTTYPE_PICU3_BASE
.set Tx_UART_Linux__LCD_COM_SEG, CYREG_PRT3_LCD_COM_SEG
.set Tx_UART_Linux__LCD_EN, CYREG_PRT3_LCD_EN
.set Tx_UART_Linux__MASK, 0x01
.set Tx_UART_Linux__PORT, 3
.set Tx_UART_Linux__PRT, CYREG_PRT3_PRT
.set Tx_UART_Linux__PRTDSI__CAPS_SEL, CYREG_PRT3_CAPS_SEL
.set Tx_UART_Linux__PRTDSI__DBL_SYNC_IN, CYREG_PRT3_DBL_SYNC_IN
.set Tx_UART_Linux__PRTDSI__OE_SEL0, CYREG_PRT3_OE_SEL0
.set Tx_UART_Linux__PRTDSI__OE_SEL1, CYREG_PRT3_OE_SEL1
.set Tx_UART_Linux__PRTDSI__OUT_SEL0, CYREG_PRT3_OUT_SEL0
.set Tx_UART_Linux__PRTDSI__OUT_SEL1, CYREG_PRT3_OUT_SEL1
.set Tx_UART_Linux__PRTDSI__SYNC_OUT, CYREG_PRT3_SYNC_OUT
.set Tx_UART_Linux__PS, CYREG_PRT3_PS
.set Tx_UART_Linux__SHIFT, 0
.set Tx_UART_Linux__SLW, CYREG_PRT3_SLW

/* Rx_UART_Debaug */
.set Rx_UART_Debaug__0__INTTYPE, CYREG_PICU12_INTTYPE0
.set Rx_UART_Debaug__0__MASK, 0x01
.set Rx_UART_Debaug__0__PC, CYREG_PRT12_PC0
.set Rx_UART_Debaug__0__PORT, 12
.set Rx_UART_Debaug__0__SHIFT, 0
.set Rx_UART_Debaug__AG, CYREG_PRT12_AG
.set Rx_UART_Debaug__BIE, CYREG_PRT12_BIE
.set Rx_UART_Debaug__BIT_MASK, CYREG_PRT12_BIT_MASK
.set Rx_UART_Debaug__BYP, CYREG_PRT12_BYP
.set Rx_UART_Debaug__DM0, CYREG_PRT12_DM0
.set Rx_UART_Debaug__DM1, CYREG_PRT12_DM1
.set Rx_UART_Debaug__DM2, CYREG_PRT12_DM2
.set Rx_UART_Debaug__DR, CYREG_PRT12_DR
.set Rx_UART_Debaug__INP_DIS, CYREG_PRT12_INP_DIS
.set Rx_UART_Debaug__INTTYPE_BASE, CYDEV_PICU_INTTYPE_PICU12_BASE
.set Rx_UART_Debaug__MASK, 0x01
.set Rx_UART_Debaug__PORT, 12
.set Rx_UART_Debaug__PRT, CYREG_PRT12_PRT
.set Rx_UART_Debaug__PRTDSI__DBL_SYNC_IN, CYREG_PRT12_DBL_SYNC_IN
.set Rx_UART_Debaug__PRTDSI__OE_SEL0, CYREG_PRT12_OE_SEL0
.set Rx_UART_Debaug__PRTDSI__OE_SEL1, CYREG_PRT12_OE_SEL1
.set Rx_UART_Debaug__PRTDSI__OUT_SEL0, CYREG_PRT12_OUT_SEL0
.set Rx_UART_Debaug__PRTDSI__OUT_SEL1, CYREG_PRT12_OUT_SEL1
.set Rx_UART_Debaug__PRTDSI__SYNC_OUT, CYREG_PRT12_SYNC_OUT
.set Rx_UART_Debaug__PS, CYREG_PRT12_PS
.set Rx_UART_Debaug__SHIFT, 0
.set Rx_UART_Debaug__SIO_CFG, CYREG_PRT12_SIO_CFG
.set Rx_UART_Debaug__SIO_DIFF, CYREG_PRT12_SIO_DIFF
.set Rx_UART_Debaug__SIO_HYST_EN, CYREG_PRT12_SIO_HYST_EN
.set Rx_UART_Debaug__SIO_REG_HIFREQ, CYREG_PRT12_SIO_REG_HIFREQ
.set Rx_UART_Debaug__SLW, CYREG_PRT12_SLW

/* Tx_UART_Debaug */
.set Tx_UART_Debaug__0__INTTYPE, CYREG_PICU12_INTTYPE1
.set Tx_UART_Debaug__0__MASK, 0x02
.set Tx_UART_Debaug__0__PC, CYREG_PRT12_PC1
.set Tx_UART_Debaug__0__PORT, 12
.set Tx_UART_Debaug__0__SHIFT, 1
.set Tx_UART_Debaug__AG, CYREG_PRT12_AG
.set Tx_UART_Debaug__BIE, CYREG_PRT12_BIE
.set Tx_UART_Debaug__BIT_MASK, CYREG_PRT12_BIT_MASK
.set Tx_UART_Debaug__BYP, CYREG_PRT12_BYP
.set Tx_UART_Debaug__DM0, CYREG_PRT12_DM0
.set Tx_UART_Debaug__DM1, CYREG_PRT12_DM1
.set Tx_UART_Debaug__DM2, CYREG_PRT12_DM2
.set Tx_UART_Debaug__DR, CYREG_PRT12_DR
.set Tx_UART_Debaug__INP_DIS, CYREG_PRT12_INP_DIS
.set Tx_UART_Debaug__INTTYPE_BASE, CYDEV_PICU_INTTYPE_PICU12_BASE
.set Tx_UART_Debaug__MASK, 0x02
.set Tx_UART_Debaug__PORT, 12
.set Tx_UART_Debaug__PRT, CYREG_PRT12_PRT
.set Tx_UART_Debaug__PRTDSI__DBL_SYNC_IN, CYREG_PRT12_DBL_SYNC_IN
.set Tx_UART_Debaug__PRTDSI__OE_SEL0, CYREG_PRT12_OE_SEL0
.set Tx_UART_Debaug__PRTDSI__OE_SEL1, CYREG_PRT12_OE_SEL1
.set Tx_UART_Debaug__PRTDSI__OUT_SEL0, CYREG_PRT12_OUT_SEL0
.set Tx_UART_Debaug__PRTDSI__OUT_SEL1, CYREG_PRT12_OUT_SEL1
.set Tx_UART_Debaug__PRTDSI__SYNC_OUT, CYREG_PRT12_SYNC_OUT
.set Tx_UART_Debaug__PS, CYREG_PRT12_PS
.set Tx_UART_Debaug__SHIFT, 1
.set Tx_UART_Debaug__SIO_CFG, CYREG_PRT12_SIO_CFG
.set Tx_UART_Debaug__SIO_DIFF, CYREG_PRT12_SIO_DIFF
.set Tx_UART_Debaug__SIO_HYST_EN, CYREG_PRT12_SIO_HYST_EN
.set Tx_UART_Debaug__SIO_REG_HIFREQ, CYREG_PRT12_SIO_REG_HIFREQ
.set Tx_UART_Debaug__SLW, CYREG_PRT12_SLW

/* intr_UART_Linux_Rx */
.set intr_UART_Linux_Rx__INTC_CLR_EN_REG, CYREG_NVIC_CLRENA0
.set intr_UART_Linux_Rx__INTC_CLR_PD_REG, CYREG_NVIC_CLRPEND0
.set intr_UART_Linux_Rx__INTC_MASK, 0x10
.set intr_UART_Linux_Rx__INTC_NUMBER, 4
.set intr_UART_Linux_Rx__INTC_PRIOR_NUM, 2
.set intr_UART_Linux_Rx__INTC_PRIOR_REG, CYREG_NVIC_PRI_4
.set intr_UART_Linux_Rx__INTC_SET_EN_REG, CYREG_NVIC_SETENA0
.set intr_UART_Linux_Rx__INTC_SET_PD_REG, CYREG_NVIC_SETPEND0

/* Miscellaneous */
.set BCLK__BUS_CLK__HZ, 48000000
.set BCLK__BUS_CLK__KHZ, 48000
.set BCLK__BUS_CLK__MHZ, 48
.set CYDEV_CHIP_DIE_LEOPARD, 1
.set CYDEV_CHIP_DIE_PSOC4A, 26
.set CYDEV_CHIP_DIE_PSOC5LP, 2
.set CYDEV_CHIP_DIE_PSOC5TM, 3
.set CYDEV_CHIP_DIE_TMA4, 4
.set CYDEV_CHIP_DIE_UNKNOWN, 0
.set CYDEV_CHIP_FAMILY_FM0P, 5
.set CYDEV_CHIP_FAMILY_FM3, 6
.set CYDEV_CHIP_FAMILY_FM4, 7
.set CYDEV_CHIP_FAMILY_PSOC3, 1
.set CYDEV_CHIP_FAMILY_PSOC4, 2
.set CYDEV_CHIP_FAMILY_PSOC5, 3
.set CYDEV_CHIP_FAMILY_PSOC6, 4
.set CYDEV_CHIP_FAMILY_UNKNOWN, 0
.set CYDEV_CHIP_FAMILY_USED, CYDEV_CHIP_FAMILY_PSOC5
.set CYDEV_CHIP_JTAG_ID, 0x2E123069
.set CYDEV_CHIP_MEMBER_3A, 1
.set CYDEV_CHIP_MEMBER_4A, 26
.set CYDEV_CHIP_MEMBER_4AA, 25
.set CYDEV_CHIP_MEMBER_4AB, 30
.set CYDEV_CHIP_MEMBER_4AC, 14
.set CYDEV_CHIP_MEMBER_4AD, 15
.set CYDEV_CHIP_MEMBER_4AE, 16
.set CYDEV_CHIP_MEMBER_4D, 20
.set CYDEV_CHIP_MEMBER_4E, 6
.set CYDEV_CHIP_MEMBER_4F, 27
.set CYDEV_CHIP_MEMBER_4G, 4
.set CYDEV_CHIP_MEMBER_4H, 24
.set CYDEV_CHIP_MEMBER_4I, 32
.set CYDEV_CHIP_MEMBER_4J, 21
.set CYDEV_CHIP_MEMBER_4K, 22
.set CYDEV_CHIP_MEMBER_4L, 31
.set CYDEV_CHIP_MEMBER_4M, 29
.set CYDEV_CHIP_MEMBER_4N, 11
.set CYDEV_CHIP_MEMBER_4O, 8
.set CYDEV_CHIP_MEMBER_4P, 28
.set CYDEV_CHIP_MEMBER_4Q, 17
.set CYDEV_CHIP_MEMBER_4R, 9
.set CYDEV_CHIP_MEMBER_4S, 12
.set CYDEV_CHIP_MEMBER_4T, 10
.set CYDEV_CHIP_MEMBER_4U, 5
.set CYDEV_CHIP_MEMBER_4V, 23
.set CYDEV_CHIP_MEMBER_4W, 13
.set CYDEV_CHIP_MEMBER_4X, 7
.set CYDEV_CHIP_MEMBER_4Y, 18
.set CYDEV_CHIP_MEMBER_4Z, 19
.set CYDEV_CHIP_MEMBER_5A, 3
.set CYDEV_CHIP_MEMBER_5B, 2
.set CYDEV_CHIP_MEMBER_6A, 33
.set CYDEV_CHIP_MEMBER_FM3, 37
.set CYDEV_CHIP_MEMBER_FM4, 38
.set CYDEV_CHIP_MEMBER_PDL_FM0P_TYPE1, 34
.set CYDEV_CHIP_MEMBER_PDL_FM0P_TYPE2, 35
.set CYDEV_CHIP_MEMBER_PDL_FM0P_TYPE3, 36
.set CYDEV_CHIP_MEMBER_UNKNOWN, 0
.set CYDEV_CHIP_MEMBER_USED, CYDEV_CHIP_MEMBER_5B
.set CYDEV_CHIP_DIE_EXPECT, CYDEV_CHIP_MEMBER_USED
.set CYDEV_CHIP_DIE_ACTUAL, CYDEV_CHIP_DIE_EXPECT
.set CYDEV_CHIP_REV_LEOPARD_ES1, 0
.set CYDEV_CHIP_REV_LEOPARD_ES2, 1
.set CYDEV_CHIP_REV_LEOPARD_ES3, 3
.set CYDEV_CHIP_REV_LEOPARD_PRODUCTION, 3
.set CYDEV_CHIP_REV_PSOC4A_ES0, 17
.set CYDEV_CHIP_REV_PSOC4A_PRODUCTION, 17
.set CYDEV_CHIP_REV_PSOC5LP_ES0, 0
.set CYDEV_CHIP_REV_PSOC5LP_PRODUCTION, 0
.set CYDEV_CHIP_REV_PSOC5TM_ES0, 0
.set CYDEV_CHIP_REV_PSOC5TM_ES1, 1
.set CYDEV_CHIP_REV_PSOC5TM_PRODUCTION, 1
.set CYDEV_CHIP_REV_TMA4_ES, 17
.set CYDEV_CHIP_REV_TMA4_ES2, 33
.set CYDEV_CHIP_REV_TMA4_PRODUCTION, 17
.set CYDEV_CHIP_REVISION_3A_ES1, 0
.set CYDEV_CHIP_REVISION_3A_ES2, 1
.set CYDEV_CHIP_REVISION_3A_ES3, 3
.set CYDEV_CHIP_REVISION_3A_PRODUCTION, 3
.set CYDEV_CHIP_REVISION_4A_ES0, 17
.set CYDEV_CHIP_REVISION_4A_PRODUCTION, 17
.set CYDEV_CHIP_REVISION_4AA_PRODUCTION, 0
.set CYDEV_CHIP_REVISION_4AB_PRODUCTION, 0
.set CYDEV_CHIP_REVISION_4AC_PRODUCTION, 0
.set CYDEV_CHIP_REVISION_4AD_PRODUCTION, 0
.set CYDEV_CHIP_REVISION_4AE_PRODUCTION, 0
.set CYDEV_CHIP_REVISION_4D_PRODUCTION, 0
.set CYDEV_CHIP_REVISION_4E_CCG2_NO_USBPD, 0
.set CYDEV_CHIP_REVISION_4E_PRODUCTION, 0
.set CYDEV_CHIP_REVISION_4F_PRODUCTION, 0
.set CYDEV_CHIP_REVISION_4F_PRODUCTION_256DMA, 0
.set CYDEV_CHIP_REVISION_4F_PRODUCTION_256K, 0
.set CYDEV_CHIP_REVISION_4G_ES, 17
.set CYDEV_CHIP_REVISION_4G_ES2, 33
.set CYDEV_CHIP_REVISION_4G_PRODUCTION, 17
.set CYDEV_CHIP_REVISION_4H_PRODUCTION, 0
.set CYDEV_CHIP_REVISION_4I_PRODUCTION, 0
.set CYDEV_CHIP_REVISION_4J_PRODUCTION, 0
.set CYDEV_CHIP_REVISION_4K_PRODUCTION, 0
.set CYDEV_CHIP_REVISION_4L_PRODUCTION, 0
.set CYDEV_CHIP_REVISION_4M_PRODUCTION, 0
.set CYDEV_CHIP_REVISION_4N_PRODUCTION, 0
.set CYDEV_CHIP_REVISION_4O_PRODUCTION, 0
.set CYDEV_CHIP_REVISION_4P_PRODUCTION, 0
.set CYDEV_CHIP_REVISION_4Q_PRODUCTION, 0
.set CYDEV_CHIP_REVISION_4R_PRODUCTION, 0
.set CYDEV_CHIP_REVISION_4S_PRODUCTION, 0
.set CYDEV_CHIP_REVISION_4T_PRODUCTION, 0
.set CYDEV_CHIP_REVISION_4U_PRODUCTION, 0
.set CYDEV_CHIP_REVISION_4V_PRODUCTION, 0
.set CYDEV_CHIP_REVISION_4W_PRODUCTION, 0
.set CYDEV_CHIP_REVISION_4X_PRODUCTION, 0
.set CYDEV_CHIP_REVISION_4Y_PRODUCTION, 0
.set CYDEV_CHIP_REVISION_4Z_PRODUCTION, 0
.set CYDEV_CHIP_REVISION_5A_ES0, 0
.set CYDEV_CHIP_REVISION_5A_ES1, 1
.set CYDEV_CHIP_REVISION_5A_PRODUCTION, 1
.set CYDEV_CHIP_REVISION_5B_ES0, 0
.set CYDEV_CHIP_REVISION_5B_PRODUCTION, 0
.set CYDEV_CHIP_REVISION_6A_ES, 17
.set CYDEV_CHIP_REVISION_6A_NO_UDB, 33
.set CYDEV_CHIP_REVISION_6A_PRODUCTION, 33
.set CYDEV_CHIP_REVISION_FM3_PRODUCTION, 0
.set CYDEV_CHIP_REVISION_FM4_PRODUCTION, 0
.set CYDEV_CHIP_REVISION_PDL_FM0P_TYPE1_PRODUCTION, 0
.set CYDEV_CHIP_REVISION_PDL_FM0P_TYPE2_PRODUCTION, 0
.set CYDEV_CHIP_REVISION_PDL_FM0P_TYPE3_PRODUCTION, 0
.set CYDEV_CHIP_REVISION_USED, CYDEV_CHIP_REVISION_5B_PRODUCTION
.set CYDEV_CHIP_REV_EXPECT, CYDEV_CHIP_REVISION_USED
.set CYDEV_CONFIG_FASTBOOT_ENABLED, 0
.set CYDEV_CONFIG_UNUSED_IO_AllowButWarn, 0
.set CYDEV_CONFIG_UNUSED_IO, CYDEV_CONFIG_UNUSED_IO_AllowButWarn
.set CYDEV_CONFIG_UNUSED_IO_AllowWithInfo, 1
.set CYDEV_CONFIG_UNUSED_IO_Disallowed, 2
.set CYDEV_CONFIGURATION_COMPRESSED, 1
.set CYDEV_CONFIGURATION_DMA, 0
.set CYDEV_CONFIGURATION_ECC, 1
.set CYDEV_CONFIGURATION_IMOENABLED, CYDEV_CONFIG_FASTBOOT_ENABLED
.set CYDEV_CONFIGURATION_MODE_COMPRESSED, 0
.set CYDEV_CONFIGURATION_MODE, CYDEV_CONFIGURATION_MODE_COMPRESSED
.set CYDEV_CONFIGURATION_MODE_DMA, 2
.set CYDEV_CONFIGURATION_MODE_UNCOMPRESSED, 1
.set CYDEV_DEBUG_ENABLE_MASK, 0x20
.set CYDEV_DEBUG_ENABLE_REGISTER, CYREG_MLOGIC_DEBUG
.set CYDEV_DEBUGGING_DPS_Disable, 3
.set CYDEV_DEBUGGING_DPS_JTAG_4, 1
.set CYDEV_DEBUGGING_DPS_JTAG_5, 0
.set CYDEV_DEBUGGING_DPS_SWD, 2
.set CYDEV_DEBUGGING_DPS_SWD_SWV, 6
.set CYDEV_DEBUGGING_DPS, CYDEV_DEBUGGING_DPS_SWD_SWV
.set CYDEV_DEBUGGING_ENABLE, 1
.set CYDEV_DEBUGGING_XRES, 0
.set CYDEV_DMA_CHANNELS_AVAILABLE, 24
.set CYDEV_ECC_ENABLE, 0
.set CYDEV_HEAP_SIZE, 0x400
.set CYDEV_INSTRUCT_CACHE_ENABLED, 1
.set CYDEV_INTR_RISING, 0x0000001F
.set CYDEV_IS_EXPORTING_CODE, 0
.set CYDEV_IS_IMPORTING_CODE, 0
.set CYDEV_PROJ_TYPE, 0
.set CYDEV_PROJ_TYPE_BOOTLOADER, 1
.set CYDEV_PROJ_TYPE_LAUNCHER, 5
.set CYDEV_PROJ_TYPE_LOADABLE, 2
.set CYDEV_PROJ_TYPE_LOADABLEANDBOOTLOADER, 4
.set CYDEV_PROJ_TYPE_MULTIAPPBOOTLOADER, 3
.set CYDEV_PROJ_TYPE_STANDARD, 0
.set CYDEV_PROTECTION_ENABLE, 0
.set CYDEV_STACK_SIZE, 0x200
.set CYDEV_USB_CLK_OSC_LOCKING_ENABLED_AT_PWR_UP, 1
.set CYDEV_USE_BUNDLED_CMSIS, 1
.set CYDEV_VARIABLE_VDDA, 0
.set CYDEV_VDDA_MV, 5000
.set CYDEV_VDDD_MV, 5000
.set CYDEV_VDDIO0_MV, 5000
.set CYDEV_VDDIO1_MV, 5000
.set CYDEV_VDDIO2_MV, 5000
.set CYDEV_VDDIO3_MV, 5000
.set CYDEV_VIO0_MV, 5000
.set CYDEV_VIO1_MV, 5000
.set CYDEV_VIO2_MV, 5000
.set CYDEV_VIO3_MV, 5000
.set CYIPBLOCK_ARM_CM3_VERSION, 0
.set CYIPBLOCK_P3_ANAIF_VERSION, 0
.set CYIPBLOCK_P3_CAN_VERSION, 0
.set CYIPBLOCK_P3_CAPSENSE_VERSION, 0
.set CYIPBLOCK_P3_COMP_VERSION, 0
.set CYIPBLOCK_P3_DECIMATOR_VERSION, 0
.set CYIPBLOCK_P3_DFB_VERSION, 0
.set CYIPBLOCK_P3_DMA_VERSION, 0
.set CYIPBLOCK_P3_DRQ_VERSION, 0
.set CYIPBLOCK_P3_DSM_VERSION, 0
.set CYIPBLOCK_P3_EMIF_VERSION, 0
.set CYIPBLOCK_P3_I2C_VERSION, 0
.set CYIPBLOCK_P3_LCD_VERSION, 0
.set CYIPBLOCK_P3_LPF_VERSION, 0
.set CYIPBLOCK_P3_OPAMP_VERSION, 0
.set CYIPBLOCK_P3_PM_VERSION, 0
.set CYIPBLOCK_P3_SCCT_VERSION, 0
.set CYIPBLOCK_P3_TIMER_VERSION, 0
.set CYIPBLOCK_P3_USB_VERSION, 0
.set CYIPBLOCK_P3_VIDAC_VERSION, 0
.set CYIPBLOCK_P3_VREF_VERSION, 0
.set CYIPBLOCK_S8_GPIO_VERSION, 0
.set CYIPBLOCK_S8_IRQ_VERSION, 0
.set CYIPBLOCK_S8_SAR_VERSION, 0
.set CYIPBLOCK_S8_SIO_VERSION, 0
.set CYIPBLOCK_S8_UDB_VERSION, 0
.set DMA_CHANNELS_USED__MASK0, 0x00000000
.set CYDEV_BOOTLOADER_ENABLE, 0
.endif
