;
; File Name: cyfitterrv.inc
; 
; PSoC Creator  4.4
;
; Description:
; 
;
;-------------------------------------------------------------------------------
; Copyright (c) 2007-2020 Cypress Semiconductor.  All rights reserved.
; You may use this file only in accordance with the license, terms, conditions, 
; disclaimers, and limitations in the end user license agreement accompanying 
; the software package with which this file was provided.
;-------------------------------------------------------------------------------

    IF :LNOT::DEF:INCLUDED_CYFITTERRV_INC
INCLUDED_CYFITTERRV_INC EQU 1
    GET cydevicerv.inc
    GET cydevicerv_trm.inc

; In4
In4__0__INTTYPE EQU CYREG_PICU2_INTTYPE4
In4__0__MASK EQU 0x10
In4__0__PC EQU CYREG_PRT2_PC4
In4__0__PORT EQU 2
In4__0__SHIFT EQU 4
In4__AG EQU CYREG_PRT2_AG
In4__AMUX EQU CYREG_PRT2_AMUX
In4__BIE EQU CYREG_PRT2_BIE
In4__BIT_MASK EQU CYREG_PRT2_BIT_MASK
In4__BYP EQU CYREG_PRT2_BYP
In4__CTL EQU CYREG_PRT2_CTL
In4__DM0 EQU CYREG_PRT2_DM0
In4__DM1 EQU CYREG_PRT2_DM1
In4__DM2 EQU CYREG_PRT2_DM2
In4__DR EQU CYREG_PRT2_DR
In4__INP_DIS EQU CYREG_PRT2_INP_DIS
In4__INTTYPE_BASE EQU CYDEV_PICU_INTTYPE_PICU2_BASE
In4__LCD_COM_SEG EQU CYREG_PRT2_LCD_COM_SEG
In4__LCD_EN EQU CYREG_PRT2_LCD_EN
In4__MASK EQU 0x10
In4__PORT EQU 2
In4__PRT EQU CYREG_PRT2_PRT
In4__PRTDSI__CAPS_SEL EQU CYREG_PRT2_CAPS_SEL
In4__PRTDSI__DBL_SYNC_IN EQU CYREG_PRT2_DBL_SYNC_IN
In4__PRTDSI__OE_SEL0 EQU CYREG_PRT2_OE_SEL0
In4__PRTDSI__OE_SEL1 EQU CYREG_PRT2_OE_SEL1
In4__PRTDSI__OUT_SEL0 EQU CYREG_PRT2_OUT_SEL0
In4__PRTDSI__OUT_SEL1 EQU CYREG_PRT2_OUT_SEL1
In4__PRTDSI__SYNC_OUT EQU CYREG_PRT2_SYNC_OUT
In4__PS EQU CYREG_PRT2_PS
In4__SHIFT EQU 4
In4__SLW EQU CYREG_PRT2_SLW

; In5
In5__0__INTTYPE EQU CYREG_PICU2_INTTYPE7
In5__0__MASK EQU 0x80
In5__0__PC EQU CYREG_PRT2_PC7
In5__0__PORT EQU 2
In5__0__SHIFT EQU 7
In5__AG EQU CYREG_PRT2_AG
In5__AMUX EQU CYREG_PRT2_AMUX
In5__BIE EQU CYREG_PRT2_BIE
In5__BIT_MASK EQU CYREG_PRT2_BIT_MASK
In5__BYP EQU CYREG_PRT2_BYP
In5__CTL EQU CYREG_PRT2_CTL
In5__DM0 EQU CYREG_PRT2_DM0
In5__DM1 EQU CYREG_PRT2_DM1
In5__DM2 EQU CYREG_PRT2_DM2
In5__DR EQU CYREG_PRT2_DR
In5__INP_DIS EQU CYREG_PRT2_INP_DIS
In5__INTTYPE_BASE EQU CYDEV_PICU_INTTYPE_PICU2_BASE
In5__LCD_COM_SEG EQU CYREG_PRT2_LCD_COM_SEG
In5__LCD_EN EQU CYREG_PRT2_LCD_EN
In5__MASK EQU 0x80
In5__PORT EQU 2
In5__PRT EQU CYREG_PRT2_PRT
In5__PRTDSI__CAPS_SEL EQU CYREG_PRT2_CAPS_SEL
In5__PRTDSI__DBL_SYNC_IN EQU CYREG_PRT2_DBL_SYNC_IN
In5__PRTDSI__OE_SEL0 EQU CYREG_PRT2_OE_SEL0
In5__PRTDSI__OE_SEL1 EQU CYREG_PRT2_OE_SEL1
In5__PRTDSI__OUT_SEL0 EQU CYREG_PRT2_OUT_SEL0
In5__PRTDSI__OUT_SEL1 EQU CYREG_PRT2_OUT_SEL1
In5__PRTDSI__SYNC_OUT EQU CYREG_PRT2_SYNC_OUT
In5__PS EQU CYREG_PRT2_PS
In5__SHIFT EQU 7
In5__SLW EQU CYREG_PRT2_SLW

; LED_RGB
LED_RGB__0__INTTYPE EQU CYREG_PICU0_INTTYPE4
LED_RGB__0__MASK EQU 0x10
LED_RGB__0__PC EQU CYREG_PRT0_PC4
LED_RGB__0__PORT EQU 0
LED_RGB__0__SHIFT EQU 4
LED_RGB__1__INTTYPE EQU CYREG_PICU0_INTTYPE5
LED_RGB__1__MASK EQU 0x20
LED_RGB__1__PC EQU CYREG_PRT0_PC5
LED_RGB__1__PORT EQU 0
LED_RGB__1__SHIFT EQU 5
LED_RGB__2__INTTYPE EQU CYREG_PICU0_INTTYPE6
LED_RGB__2__MASK EQU 0x40
LED_RGB__2__PC EQU CYREG_PRT0_PC6
LED_RGB__2__PORT EQU 0
LED_RGB__2__SHIFT EQU 6
LED_RGB__AG EQU CYREG_PRT0_AG
LED_RGB__AMUX EQU CYREG_PRT0_AMUX
LED_RGB__BIE EQU CYREG_PRT0_BIE
LED_RGB__BIT_MASK EQU CYREG_PRT0_BIT_MASK
LED_RGB__BYP EQU CYREG_PRT0_BYP
LED_RGB__CTL EQU CYREG_PRT0_CTL
LED_RGB__DM0 EQU CYREG_PRT0_DM0
LED_RGB__DM1 EQU CYREG_PRT0_DM1
LED_RGB__DM2 EQU CYREG_PRT0_DM2
LED_RGB__DR EQU CYREG_PRT0_DR
LED_RGB__INP_DIS EQU CYREG_PRT0_INP_DIS
LED_RGB__INTTYPE_BASE EQU CYDEV_PICU_INTTYPE_PICU0_BASE
LED_RGB__LCD_COM_SEG EQU CYREG_PRT0_LCD_COM_SEG
LED_RGB__LCD_EN EQU CYREG_PRT0_LCD_EN
LED_RGB__MASK EQU 0x70
LED_RGB__PORT EQU 0
LED_RGB__PRT EQU CYREG_PRT0_PRT
LED_RGB__PRTDSI__CAPS_SEL EQU CYREG_PRT0_CAPS_SEL
LED_RGB__PRTDSI__DBL_SYNC_IN EQU CYREG_PRT0_DBL_SYNC_IN
LED_RGB__PRTDSI__OE_SEL0 EQU CYREG_PRT0_OE_SEL0
LED_RGB__PRTDSI__OE_SEL1 EQU CYREG_PRT0_OE_SEL1
LED_RGB__PRTDSI__OUT_SEL0 EQU CYREG_PRT0_OUT_SEL0
LED_RGB__PRTDSI__OUT_SEL1 EQU CYREG_PRT0_OUT_SEL1
LED_RGB__PRTDSI__SYNC_OUT EQU CYREG_PRT0_SYNC_OUT
LED_RGB__PS EQU CYREG_PRT0_PS
LED_RGB__SHIFT EQU 4
LED_RGB__SLW EQU CYREG_PRT0_SLW

; Pins_Port1
Pins_Port1__0__INTTYPE EQU CYREG_PICU2_INTTYPE1
Pins_Port1__0__MASK EQU 0x02
Pins_Port1__0__PC EQU CYREG_PRT2_PC1
Pins_Port1__0__PORT EQU 2
Pins_Port1__0__SHIFT EQU 1
Pins_Port1__1__INTTYPE EQU CYREG_PICU2_INTTYPE2
Pins_Port1__1__MASK EQU 0x04
Pins_Port1__1__PC EQU CYREG_PRT2_PC2
Pins_Port1__1__PORT EQU 2
Pins_Port1__1__SHIFT EQU 2
Pins_Port1__2__INTTYPE EQU CYREG_PICU2_INTTYPE3
Pins_Port1__2__MASK EQU 0x08
Pins_Port1__2__PC EQU CYREG_PRT2_PC3
Pins_Port1__2__PORT EQU 2
Pins_Port1__2__SHIFT EQU 3
Pins_Port1__AG EQU CYREG_PRT2_AG
Pins_Port1__AMUX EQU CYREG_PRT2_AMUX
Pins_Port1__BIE EQU CYREG_PRT2_BIE
Pins_Port1__BIT_MASK EQU CYREG_PRT2_BIT_MASK
Pins_Port1__BYP EQU CYREG_PRT2_BYP
Pins_Port1__CTL EQU CYREG_PRT2_CTL
Pins_Port1__DM0 EQU CYREG_PRT2_DM0
Pins_Port1__DM1 EQU CYREG_PRT2_DM1
Pins_Port1__DM2 EQU CYREG_PRT2_DM2
Pins_Port1__DR EQU CYREG_PRT2_DR
Pins_Port1__INP_DIS EQU CYREG_PRT2_INP_DIS
Pins_Port1__INTSTAT EQU CYREG_PICU2_INTSTAT
Pins_Port1__INTTYPE_BASE EQU CYDEV_PICU_INTTYPE_PICU2_BASE
Pins_Port1__LCD_COM_SEG EQU CYREG_PRT2_LCD_COM_SEG
Pins_Port1__LCD_EN EQU CYREG_PRT2_LCD_EN
Pins_Port1__MASK EQU 0x0E
Pins_Port1__PORT EQU 2
Pins_Port1__PRT EQU CYREG_PRT2_PRT
Pins_Port1__PRTDSI__CAPS_SEL EQU CYREG_PRT2_CAPS_SEL
Pins_Port1__PRTDSI__DBL_SYNC_IN EQU CYREG_PRT2_DBL_SYNC_IN
Pins_Port1__PRTDSI__OE_SEL0 EQU CYREG_PRT2_OE_SEL0
Pins_Port1__PRTDSI__OE_SEL1 EQU CYREG_PRT2_OE_SEL1
Pins_Port1__PRTDSI__OUT_SEL0 EQU CYREG_PRT2_OUT_SEL0
Pins_Port1__PRTDSI__OUT_SEL1 EQU CYREG_PRT2_OUT_SEL1
Pins_Port1__PRTDSI__SYNC_OUT EQU CYREG_PRT2_SYNC_OUT
Pins_Port1__PS EQU CYREG_PRT2_PS
Pins_Port1__SHIFT EQU 1
Pins_Port1__SLW EQU CYREG_PRT2_SLW
Pins_Port1__SNAP EQU CYREG_PICU2_SNAP

; Pins_Port2
Pins_Port2__0__INTTYPE EQU CYREG_PICU6_INTTYPE4
Pins_Port2__0__MASK EQU 0x10
Pins_Port2__0__PC EQU CYREG_PRT6_PC4
Pins_Port2__0__PORT EQU 6
Pins_Port2__0__SHIFT EQU 4
Pins_Port2__1__INTTYPE EQU CYREG_PICU6_INTTYPE5
Pins_Port2__1__MASK EQU 0x20
Pins_Port2__1__PC EQU CYREG_PRT6_PC5
Pins_Port2__1__PORT EQU 6
Pins_Port2__1__SHIFT EQU 5
Pins_Port2__2__INTTYPE EQU CYREG_PICU6_INTTYPE6
Pins_Port2__2__MASK EQU 0x40
Pins_Port2__2__PC EQU CYREG_PRT6_PC6
Pins_Port2__2__PORT EQU 6
Pins_Port2__2__SHIFT EQU 6
Pins_Port2__AG EQU CYREG_PRT6_AG
Pins_Port2__AMUX EQU CYREG_PRT6_AMUX
Pins_Port2__BIE EQU CYREG_PRT6_BIE
Pins_Port2__BIT_MASK EQU CYREG_PRT6_BIT_MASK
Pins_Port2__BYP EQU CYREG_PRT6_BYP
Pins_Port2__CTL EQU CYREG_PRT6_CTL
Pins_Port2__DM0 EQU CYREG_PRT6_DM0
Pins_Port2__DM1 EQU CYREG_PRT6_DM1
Pins_Port2__DM2 EQU CYREG_PRT6_DM2
Pins_Port2__DR EQU CYREG_PRT6_DR
Pins_Port2__INP_DIS EQU CYREG_PRT6_INP_DIS
Pins_Port2__INTSTAT EQU CYREG_PICU6_INTSTAT
Pins_Port2__INTTYPE_BASE EQU CYDEV_PICU_INTTYPE_PICU6_BASE
Pins_Port2__LCD_COM_SEG EQU CYREG_PRT6_LCD_COM_SEG
Pins_Port2__LCD_EN EQU CYREG_PRT6_LCD_EN
Pins_Port2__MASK EQU 0x70
Pins_Port2__PORT EQU 6
Pins_Port2__PRT EQU CYREG_PRT6_PRT
Pins_Port2__PRTDSI__CAPS_SEL EQU CYREG_PRT6_CAPS_SEL
Pins_Port2__PRTDSI__DBL_SYNC_IN EQU CYREG_PRT6_DBL_SYNC_IN
Pins_Port2__PRTDSI__OE_SEL0 EQU CYREG_PRT6_OE_SEL0
Pins_Port2__PRTDSI__OE_SEL1 EQU CYREG_PRT6_OE_SEL1
Pins_Port2__PRTDSI__OUT_SEL0 EQU CYREG_PRT6_OUT_SEL0
Pins_Port2__PRTDSI__OUT_SEL1 EQU CYREG_PRT6_OUT_SEL1
Pins_Port2__PRTDSI__SYNC_OUT EQU CYREG_PRT6_SYNC_OUT
Pins_Port2__PS EQU CYREG_PRT6_PS
Pins_Port2__SHIFT EQU 4
Pins_Port2__SLW EQU CYREG_PRT6_SLW
Pins_Port2__SNAP EQU CYREG_PICU6_SNAP

; UART_Debug
UART_Debug_BUART_sRX_RxBitCounter__16BIT_CONTROL_AUX_CTL_REG EQU CYREG_B1_UDB04_05_ACTL
UART_Debug_BUART_sRX_RxBitCounter__16BIT_CONTROL_CONTROL_REG EQU CYREG_B1_UDB04_05_CTL
UART_Debug_BUART_sRX_RxBitCounter__16BIT_CONTROL_COUNT_REG EQU CYREG_B1_UDB04_05_CTL
UART_Debug_BUART_sRX_RxBitCounter__16BIT_COUNT_CONTROL_REG EQU CYREG_B1_UDB04_05_CTL
UART_Debug_BUART_sRX_RxBitCounter__16BIT_COUNT_COUNT_REG EQU CYREG_B1_UDB04_05_CTL
UART_Debug_BUART_sRX_RxBitCounter__16BIT_MASK_MASK_REG EQU CYREG_B1_UDB04_05_MSK
UART_Debug_BUART_sRX_RxBitCounter__16BIT_MASK_PERIOD_REG EQU CYREG_B1_UDB04_05_MSK
UART_Debug_BUART_sRX_RxBitCounter__16BIT_PERIOD_MASK_REG EQU CYREG_B1_UDB04_05_MSK
UART_Debug_BUART_sRX_RxBitCounter__16BIT_PERIOD_PERIOD_REG EQU CYREG_B1_UDB04_05_MSK
UART_Debug_BUART_sRX_RxBitCounter__CONTROL_AUX_CTL_REG EQU CYREG_B1_UDB04_ACTL
UART_Debug_BUART_sRX_RxBitCounter__CONTROL_REG EQU CYREG_B1_UDB04_CTL
UART_Debug_BUART_sRX_RxBitCounter__CONTROL_ST_REG EQU CYREG_B1_UDB04_ST_CTL
UART_Debug_BUART_sRX_RxBitCounter__COUNT_REG EQU CYREG_B1_UDB04_CTL
UART_Debug_BUART_sRX_RxBitCounter__COUNT_ST_REG EQU CYREG_B1_UDB04_ST_CTL
UART_Debug_BUART_sRX_RxBitCounter__MASK_CTL_AUX_CTL_REG EQU CYREG_B1_UDB04_MSK_ACTL
UART_Debug_BUART_sRX_RxBitCounter__PER_CTL_AUX_CTL_REG EQU CYREG_B1_UDB04_MSK_ACTL
UART_Debug_BUART_sRX_RxBitCounter__PERIOD_REG EQU CYREG_B1_UDB04_MSK
UART_Debug_BUART_sRX_RxBitCounter_ST__16BIT_STATUS_AUX_CTL_REG EQU CYREG_B1_UDB04_05_ACTL
UART_Debug_BUART_sRX_RxBitCounter_ST__16BIT_STATUS_REG EQU CYREG_B1_UDB04_05_ST
UART_Debug_BUART_sRX_RxBitCounter_ST__MASK_REG EQU CYREG_B1_UDB04_MSK
UART_Debug_BUART_sRX_RxBitCounter_ST__MASK_ST_AUX_CTL_REG EQU CYREG_B1_UDB04_MSK_ACTL
UART_Debug_BUART_sRX_RxBitCounter_ST__PER_ST_AUX_CTL_REG EQU CYREG_B1_UDB04_MSK_ACTL
UART_Debug_BUART_sRX_RxBitCounter_ST__STATUS_AUX_CTL_REG EQU CYREG_B1_UDB04_ACTL
UART_Debug_BUART_sRX_RxBitCounter_ST__STATUS_CNT_REG EQU CYREG_B1_UDB04_ST_CTL
UART_Debug_BUART_sRX_RxBitCounter_ST__STATUS_CONTROL_REG EQU CYREG_B1_UDB04_ST_CTL
UART_Debug_BUART_sRX_RxBitCounter_ST__STATUS_REG EQU CYREG_B1_UDB04_ST
UART_Debug_BUART_sRX_RxShifter_u0__16BIT_A0_REG EQU CYREG_B1_UDB04_05_A0
UART_Debug_BUART_sRX_RxShifter_u0__16BIT_A1_REG EQU CYREG_B1_UDB04_05_A1
UART_Debug_BUART_sRX_RxShifter_u0__16BIT_D0_REG EQU CYREG_B1_UDB04_05_D0
UART_Debug_BUART_sRX_RxShifter_u0__16BIT_D1_REG EQU CYREG_B1_UDB04_05_D1
UART_Debug_BUART_sRX_RxShifter_u0__16BIT_DP_AUX_CTL_REG EQU CYREG_B1_UDB04_05_ACTL
UART_Debug_BUART_sRX_RxShifter_u0__16BIT_F0_REG EQU CYREG_B1_UDB04_05_F0
UART_Debug_BUART_sRX_RxShifter_u0__16BIT_F1_REG EQU CYREG_B1_UDB04_05_F1
UART_Debug_BUART_sRX_RxShifter_u0__A0_A1_REG EQU CYREG_B1_UDB04_A0_A1
UART_Debug_BUART_sRX_RxShifter_u0__A0_REG EQU CYREG_B1_UDB04_A0
UART_Debug_BUART_sRX_RxShifter_u0__A1_REG EQU CYREG_B1_UDB04_A1
UART_Debug_BUART_sRX_RxShifter_u0__D0_D1_REG EQU CYREG_B1_UDB04_D0_D1
UART_Debug_BUART_sRX_RxShifter_u0__D0_REG EQU CYREG_B1_UDB04_D0
UART_Debug_BUART_sRX_RxShifter_u0__D1_REG EQU CYREG_B1_UDB04_D1
UART_Debug_BUART_sRX_RxShifter_u0__DP_AUX_CTL_REG EQU CYREG_B1_UDB04_ACTL
UART_Debug_BUART_sRX_RxShifter_u0__F0_F1_REG EQU CYREG_B1_UDB04_F0_F1
UART_Debug_BUART_sRX_RxShifter_u0__F0_REG EQU CYREG_B1_UDB04_F0
UART_Debug_BUART_sRX_RxShifter_u0__F1_REG EQU CYREG_B1_UDB04_F1
UART_Debug_BUART_sRX_RxShifter_u0__MSK_DP_AUX_CTL_REG EQU CYREG_B1_UDB04_MSK_ACTL
UART_Debug_BUART_sRX_RxShifter_u0__PER_DP_AUX_CTL_REG EQU CYREG_B1_UDB04_MSK_ACTL
UART_Debug_BUART_sRX_RxSts__16BIT_STATUS_AUX_CTL_REG EQU CYREG_B1_UDB07_08_ACTL
UART_Debug_BUART_sRX_RxSts__16BIT_STATUS_REG EQU CYREG_B1_UDB07_08_ST
UART_Debug_BUART_sRX_RxSts__3__MASK EQU 0x08
UART_Debug_BUART_sRX_RxSts__3__POS EQU 3
UART_Debug_BUART_sRX_RxSts__4__MASK EQU 0x10
UART_Debug_BUART_sRX_RxSts__4__POS EQU 4
UART_Debug_BUART_sRX_RxSts__5__MASK EQU 0x20
UART_Debug_BUART_sRX_RxSts__5__POS EQU 5
UART_Debug_BUART_sRX_RxSts__MASK EQU 0x38
UART_Debug_BUART_sRX_RxSts__MASK_REG EQU CYREG_B1_UDB07_MSK
UART_Debug_BUART_sRX_RxSts__STATUS_AUX_CTL_REG EQU CYREG_B1_UDB07_ACTL
UART_Debug_BUART_sRX_RxSts__STATUS_REG EQU CYREG_B1_UDB07_ST
UART_Debug_BUART_sTX_sCLOCK_TxBitClkGen__16BIT_A0_REG EQU CYREG_B1_UDB07_08_A0
UART_Debug_BUART_sTX_sCLOCK_TxBitClkGen__16BIT_A1_REG EQU CYREG_B1_UDB07_08_A1
UART_Debug_BUART_sTX_sCLOCK_TxBitClkGen__16BIT_D0_REG EQU CYREG_B1_UDB07_08_D0
UART_Debug_BUART_sTX_sCLOCK_TxBitClkGen__16BIT_D1_REG EQU CYREG_B1_UDB07_08_D1
UART_Debug_BUART_sTX_sCLOCK_TxBitClkGen__16BIT_DP_AUX_CTL_REG EQU CYREG_B1_UDB07_08_ACTL
UART_Debug_BUART_sTX_sCLOCK_TxBitClkGen__16BIT_F0_REG EQU CYREG_B1_UDB07_08_F0
UART_Debug_BUART_sTX_sCLOCK_TxBitClkGen__16BIT_F1_REG EQU CYREG_B1_UDB07_08_F1
UART_Debug_BUART_sTX_sCLOCK_TxBitClkGen__A0_A1_REG EQU CYREG_B1_UDB07_A0_A1
UART_Debug_BUART_sTX_sCLOCK_TxBitClkGen__A0_REG EQU CYREG_B1_UDB07_A0
UART_Debug_BUART_sTX_sCLOCK_TxBitClkGen__A1_REG EQU CYREG_B1_UDB07_A1
UART_Debug_BUART_sTX_sCLOCK_TxBitClkGen__D0_D1_REG EQU CYREG_B1_UDB07_D0_D1
UART_Debug_BUART_sTX_sCLOCK_TxBitClkGen__D0_REG EQU CYREG_B1_UDB07_D0
UART_Debug_BUART_sTX_sCLOCK_TxBitClkGen__D1_REG EQU CYREG_B1_UDB07_D1
UART_Debug_BUART_sTX_sCLOCK_TxBitClkGen__DP_AUX_CTL_REG EQU CYREG_B1_UDB07_ACTL
UART_Debug_BUART_sTX_sCLOCK_TxBitClkGen__F0_F1_REG EQU CYREG_B1_UDB07_F0_F1
UART_Debug_BUART_sTX_sCLOCK_TxBitClkGen__F0_REG EQU CYREG_B1_UDB07_F0
UART_Debug_BUART_sTX_sCLOCK_TxBitClkGen__F1_REG EQU CYREG_B1_UDB07_F1
UART_Debug_BUART_sTX_TxShifter_u0__16BIT_A0_REG EQU CYREG_B0_UDB07_08_A0
UART_Debug_BUART_sTX_TxShifter_u0__16BIT_A1_REG EQU CYREG_B0_UDB07_08_A1
UART_Debug_BUART_sTX_TxShifter_u0__16BIT_D0_REG EQU CYREG_B0_UDB07_08_D0
UART_Debug_BUART_sTX_TxShifter_u0__16BIT_D1_REG EQU CYREG_B0_UDB07_08_D1
UART_Debug_BUART_sTX_TxShifter_u0__16BIT_DP_AUX_CTL_REG EQU CYREG_B0_UDB07_08_ACTL
UART_Debug_BUART_sTX_TxShifter_u0__16BIT_F0_REG EQU CYREG_B0_UDB07_08_F0
UART_Debug_BUART_sTX_TxShifter_u0__16BIT_F1_REG EQU CYREG_B0_UDB07_08_F1
UART_Debug_BUART_sTX_TxShifter_u0__A0_A1_REG EQU CYREG_B0_UDB07_A0_A1
UART_Debug_BUART_sTX_TxShifter_u0__A0_REG EQU CYREG_B0_UDB07_A0
UART_Debug_BUART_sTX_TxShifter_u0__A1_REG EQU CYREG_B0_UDB07_A1
UART_Debug_BUART_sTX_TxShifter_u0__D0_D1_REG EQU CYREG_B0_UDB07_D0_D1
UART_Debug_BUART_sTX_TxShifter_u0__D0_REG EQU CYREG_B0_UDB07_D0
UART_Debug_BUART_sTX_TxShifter_u0__D1_REG EQU CYREG_B0_UDB07_D1
UART_Debug_BUART_sTX_TxShifter_u0__DP_AUX_CTL_REG EQU CYREG_B0_UDB07_ACTL
UART_Debug_BUART_sTX_TxShifter_u0__F0_F1_REG EQU CYREG_B0_UDB07_F0_F1
UART_Debug_BUART_sTX_TxShifter_u0__F0_REG EQU CYREG_B0_UDB07_F0
UART_Debug_BUART_sTX_TxShifter_u0__F1_REG EQU CYREG_B0_UDB07_F1
UART_Debug_BUART_sTX_TxSts__0__MASK EQU 0x01
UART_Debug_BUART_sTX_TxSts__0__POS EQU 0
UART_Debug_BUART_sTX_TxSts__1__MASK EQU 0x02
UART_Debug_BUART_sTX_TxSts__1__POS EQU 1
UART_Debug_BUART_sTX_TxSts__16BIT_STATUS_AUX_CTL_REG EQU CYREG_B0_UDB07_08_ACTL
UART_Debug_BUART_sTX_TxSts__16BIT_STATUS_REG EQU CYREG_B0_UDB07_08_ST
UART_Debug_BUART_sTX_TxSts__2__MASK EQU 0x04
UART_Debug_BUART_sTX_TxSts__2__POS EQU 2
UART_Debug_BUART_sTX_TxSts__3__MASK EQU 0x08
UART_Debug_BUART_sTX_TxSts__3__POS EQU 3
UART_Debug_BUART_sTX_TxSts__MASK EQU 0x0F
UART_Debug_BUART_sTX_TxSts__MASK_REG EQU CYREG_B0_UDB07_MSK
UART_Debug_BUART_sTX_TxSts__STATUS_AUX_CTL_REG EQU CYREG_B0_UDB07_ACTL
UART_Debug_BUART_sTX_TxSts__STATUS_REG EQU CYREG_B0_UDB07_ST
UART_Debug_IntClock__CFG0 EQU CYREG_CLKDIST_DCFG1_CFG0
UART_Debug_IntClock__CFG1 EQU CYREG_CLKDIST_DCFG1_CFG1
UART_Debug_IntClock__CFG2 EQU CYREG_CLKDIST_DCFG1_CFG2
UART_Debug_IntClock__CFG2_SRC_SEL_MASK EQU 0x07
UART_Debug_IntClock__INDEX EQU 0x01
UART_Debug_IntClock__PM_ACT_CFG EQU CYREG_PM_ACT_CFG2
UART_Debug_IntClock__PM_ACT_MSK EQU 0x02
UART_Debug_IntClock__PM_STBY_CFG EQU CYREG_PM_STBY_CFG2
UART_Debug_IntClock__PM_STBY_MSK EQU 0x02
UART_Debug_RXInternalInterrupt__INTC_CLR_EN_REG EQU CYREG_NVIC_CLRENA0
UART_Debug_RXInternalInterrupt__INTC_CLR_PD_REG EQU CYREG_NVIC_CLRPEND0
UART_Debug_RXInternalInterrupt__INTC_MASK EQU 0x01
UART_Debug_RXInternalInterrupt__INTC_NUMBER EQU 0
UART_Debug_RXInternalInterrupt__INTC_PRIOR_NUM EQU 7
UART_Debug_RXInternalInterrupt__INTC_PRIOR_REG EQU CYREG_NVIC_PRI_0
UART_Debug_RXInternalInterrupt__INTC_SET_EN_REG EQU CYREG_NVIC_SETENA0
UART_Debug_RXInternalInterrupt__INTC_SET_PD_REG EQU CYREG_NVIC_SETPEND0
UART_Debug_TXInternalInterrupt__INTC_CLR_EN_REG EQU CYREG_NVIC_CLRENA0
UART_Debug_TXInternalInterrupt__INTC_CLR_PD_REG EQU CYREG_NVIC_CLRPEND0
UART_Debug_TXInternalInterrupt__INTC_MASK EQU 0x02
UART_Debug_TXInternalInterrupt__INTC_NUMBER EQU 1
UART_Debug_TXInternalInterrupt__INTC_PRIOR_NUM EQU 7
UART_Debug_TXInternalInterrupt__INTC_PRIOR_REG EQU CYREG_NVIC_PRI_1
UART_Debug_TXInternalInterrupt__INTC_SET_EN_REG EQU CYREG_NVIC_SETENA0
UART_Debug_TXInternalInterrupt__INTC_SET_PD_REG EQU CYREG_NVIC_SETPEND0

; UART_Linux
UART_Linux_BUART_sRX_RxBitCounter__16BIT_CONTROL_AUX_CTL_REG EQU CYREG_B0_UDB02_03_ACTL
UART_Linux_BUART_sRX_RxBitCounter__16BIT_CONTROL_CONTROL_REG EQU CYREG_B0_UDB02_03_CTL
UART_Linux_BUART_sRX_RxBitCounter__16BIT_CONTROL_COUNT_REG EQU CYREG_B0_UDB02_03_CTL
UART_Linux_BUART_sRX_RxBitCounter__16BIT_COUNT_CONTROL_REG EQU CYREG_B0_UDB02_03_CTL
UART_Linux_BUART_sRX_RxBitCounter__16BIT_COUNT_COUNT_REG EQU CYREG_B0_UDB02_03_CTL
UART_Linux_BUART_sRX_RxBitCounter__16BIT_MASK_MASK_REG EQU CYREG_B0_UDB02_03_MSK
UART_Linux_BUART_sRX_RxBitCounter__16BIT_MASK_PERIOD_REG EQU CYREG_B0_UDB02_03_MSK
UART_Linux_BUART_sRX_RxBitCounter__16BIT_PERIOD_MASK_REG EQU CYREG_B0_UDB02_03_MSK
UART_Linux_BUART_sRX_RxBitCounter__16BIT_PERIOD_PERIOD_REG EQU CYREG_B0_UDB02_03_MSK
UART_Linux_BUART_sRX_RxBitCounter__CONTROL_AUX_CTL_REG EQU CYREG_B0_UDB02_ACTL
UART_Linux_BUART_sRX_RxBitCounter__CONTROL_REG EQU CYREG_B0_UDB02_CTL
UART_Linux_BUART_sRX_RxBitCounter__CONTROL_ST_REG EQU CYREG_B0_UDB02_ST_CTL
UART_Linux_BUART_sRX_RxBitCounter__COUNT_REG EQU CYREG_B0_UDB02_CTL
UART_Linux_BUART_sRX_RxBitCounter__COUNT_ST_REG EQU CYREG_B0_UDB02_ST_CTL
UART_Linux_BUART_sRX_RxBitCounter__MASK_CTL_AUX_CTL_REG EQU CYREG_B0_UDB02_MSK_ACTL
UART_Linux_BUART_sRX_RxBitCounter__PER_CTL_AUX_CTL_REG EQU CYREG_B0_UDB02_MSK_ACTL
UART_Linux_BUART_sRX_RxBitCounter__PERIOD_REG EQU CYREG_B0_UDB02_MSK
UART_Linux_BUART_sRX_RxBitCounter_ST__16BIT_STATUS_AUX_CTL_REG EQU CYREG_B0_UDB02_03_ACTL
UART_Linux_BUART_sRX_RxBitCounter_ST__16BIT_STATUS_REG EQU CYREG_B0_UDB02_03_ST
UART_Linux_BUART_sRX_RxBitCounter_ST__MASK_REG EQU CYREG_B0_UDB02_MSK
UART_Linux_BUART_sRX_RxBitCounter_ST__MASK_ST_AUX_CTL_REG EQU CYREG_B0_UDB02_MSK_ACTL
UART_Linux_BUART_sRX_RxBitCounter_ST__PER_ST_AUX_CTL_REG EQU CYREG_B0_UDB02_MSK_ACTL
UART_Linux_BUART_sRX_RxBitCounter_ST__STATUS_AUX_CTL_REG EQU CYREG_B0_UDB02_ACTL
UART_Linux_BUART_sRX_RxBitCounter_ST__STATUS_CNT_REG EQU CYREG_B0_UDB02_ST_CTL
UART_Linux_BUART_sRX_RxBitCounter_ST__STATUS_CONTROL_REG EQU CYREG_B0_UDB02_ST_CTL
UART_Linux_BUART_sRX_RxBitCounter_ST__STATUS_REG EQU CYREG_B0_UDB02_ST
UART_Linux_BUART_sRX_RxShifter_u0__16BIT_A0_REG EQU CYREG_B0_UDB05_06_A0
UART_Linux_BUART_sRX_RxShifter_u0__16BIT_A1_REG EQU CYREG_B0_UDB05_06_A1
UART_Linux_BUART_sRX_RxShifter_u0__16BIT_D0_REG EQU CYREG_B0_UDB05_06_D0
UART_Linux_BUART_sRX_RxShifter_u0__16BIT_D1_REG EQU CYREG_B0_UDB05_06_D1
UART_Linux_BUART_sRX_RxShifter_u0__16BIT_DP_AUX_CTL_REG EQU CYREG_B0_UDB05_06_ACTL
UART_Linux_BUART_sRX_RxShifter_u0__16BIT_F0_REG EQU CYREG_B0_UDB05_06_F0
UART_Linux_BUART_sRX_RxShifter_u0__16BIT_F1_REG EQU CYREG_B0_UDB05_06_F1
UART_Linux_BUART_sRX_RxShifter_u0__A0_A1_REG EQU CYREG_B0_UDB05_A0_A1
UART_Linux_BUART_sRX_RxShifter_u0__A0_REG EQU CYREG_B0_UDB05_A0
UART_Linux_BUART_sRX_RxShifter_u0__A1_REG EQU CYREG_B0_UDB05_A1
UART_Linux_BUART_sRX_RxShifter_u0__D0_D1_REG EQU CYREG_B0_UDB05_D0_D1
UART_Linux_BUART_sRX_RxShifter_u0__D0_REG EQU CYREG_B0_UDB05_D0
UART_Linux_BUART_sRX_RxShifter_u0__D1_REG EQU CYREG_B0_UDB05_D1
UART_Linux_BUART_sRX_RxShifter_u0__DP_AUX_CTL_REG EQU CYREG_B0_UDB05_ACTL
UART_Linux_BUART_sRX_RxShifter_u0__F0_F1_REG EQU CYREG_B0_UDB05_F0_F1
UART_Linux_BUART_sRX_RxShifter_u0__F0_REG EQU CYREG_B0_UDB05_F0
UART_Linux_BUART_sRX_RxShifter_u0__F1_REG EQU CYREG_B0_UDB05_F1
UART_Linux_BUART_sRX_RxSts__16BIT_STATUS_AUX_CTL_REG EQU CYREG_B0_UDB05_06_ACTL
UART_Linux_BUART_sRX_RxSts__16BIT_STATUS_REG EQU CYREG_B0_UDB05_06_ST
UART_Linux_BUART_sRX_RxSts__3__MASK EQU 0x08
UART_Linux_BUART_sRX_RxSts__3__POS EQU 3
UART_Linux_BUART_sRX_RxSts__4__MASK EQU 0x10
UART_Linux_BUART_sRX_RxSts__4__POS EQU 4
UART_Linux_BUART_sRX_RxSts__5__MASK EQU 0x20
UART_Linux_BUART_sRX_RxSts__5__POS EQU 5
UART_Linux_BUART_sRX_RxSts__MASK EQU 0x38
UART_Linux_BUART_sRX_RxSts__MASK_REG EQU CYREG_B0_UDB05_MSK
UART_Linux_BUART_sRX_RxSts__STATUS_AUX_CTL_REG EQU CYREG_B0_UDB05_ACTL
UART_Linux_BUART_sRX_RxSts__STATUS_REG EQU CYREG_B0_UDB05_ST
UART_Linux_BUART_sTX_sCLOCK_TxBitClkGen__16BIT_A0_REG EQU CYREG_B0_UDB06_07_A0
UART_Linux_BUART_sTX_sCLOCK_TxBitClkGen__16BIT_A1_REG EQU CYREG_B0_UDB06_07_A1
UART_Linux_BUART_sTX_sCLOCK_TxBitClkGen__16BIT_D0_REG EQU CYREG_B0_UDB06_07_D0
UART_Linux_BUART_sTX_sCLOCK_TxBitClkGen__16BIT_D1_REG EQU CYREG_B0_UDB06_07_D1
UART_Linux_BUART_sTX_sCLOCK_TxBitClkGen__16BIT_DP_AUX_CTL_REG EQU CYREG_B0_UDB06_07_ACTL
UART_Linux_BUART_sTX_sCLOCK_TxBitClkGen__16BIT_F0_REG EQU CYREG_B0_UDB06_07_F0
UART_Linux_BUART_sTX_sCLOCK_TxBitClkGen__16BIT_F1_REG EQU CYREG_B0_UDB06_07_F1
UART_Linux_BUART_sTX_sCLOCK_TxBitClkGen__A0_A1_REG EQU CYREG_B0_UDB06_A0_A1
UART_Linux_BUART_sTX_sCLOCK_TxBitClkGen__A0_REG EQU CYREG_B0_UDB06_A0
UART_Linux_BUART_sTX_sCLOCK_TxBitClkGen__A1_REG EQU CYREG_B0_UDB06_A1
UART_Linux_BUART_sTX_sCLOCK_TxBitClkGen__D0_D1_REG EQU CYREG_B0_UDB06_D0_D1
UART_Linux_BUART_sTX_sCLOCK_TxBitClkGen__D0_REG EQU CYREG_B0_UDB06_D0
UART_Linux_BUART_sTX_sCLOCK_TxBitClkGen__D1_REG EQU CYREG_B0_UDB06_D1
UART_Linux_BUART_sTX_sCLOCK_TxBitClkGen__DP_AUX_CTL_REG EQU CYREG_B0_UDB06_ACTL
UART_Linux_BUART_sTX_sCLOCK_TxBitClkGen__F0_F1_REG EQU CYREG_B0_UDB06_F0_F1
UART_Linux_BUART_sTX_sCLOCK_TxBitClkGen__F0_REG EQU CYREG_B0_UDB06_F0
UART_Linux_BUART_sTX_sCLOCK_TxBitClkGen__F1_REG EQU CYREG_B0_UDB06_F1
UART_Linux_BUART_sTX_TxShifter_u0__16BIT_A0_REG EQU CYREG_B1_UDB06_07_A0
UART_Linux_BUART_sTX_TxShifter_u0__16BIT_A1_REG EQU CYREG_B1_UDB06_07_A1
UART_Linux_BUART_sTX_TxShifter_u0__16BIT_D0_REG EQU CYREG_B1_UDB06_07_D0
UART_Linux_BUART_sTX_TxShifter_u0__16BIT_D1_REG EQU CYREG_B1_UDB06_07_D1
UART_Linux_BUART_sTX_TxShifter_u0__16BIT_DP_AUX_CTL_REG EQU CYREG_B1_UDB06_07_ACTL
UART_Linux_BUART_sTX_TxShifter_u0__16BIT_F0_REG EQU CYREG_B1_UDB06_07_F0
UART_Linux_BUART_sTX_TxShifter_u0__16BIT_F1_REG EQU CYREG_B1_UDB06_07_F1
UART_Linux_BUART_sTX_TxShifter_u0__A0_A1_REG EQU CYREG_B1_UDB06_A0_A1
UART_Linux_BUART_sTX_TxShifter_u0__A0_REG EQU CYREG_B1_UDB06_A0
UART_Linux_BUART_sTX_TxShifter_u0__A1_REG EQU CYREG_B1_UDB06_A1
UART_Linux_BUART_sTX_TxShifter_u0__D0_D1_REG EQU CYREG_B1_UDB06_D0_D1
UART_Linux_BUART_sTX_TxShifter_u0__D0_REG EQU CYREG_B1_UDB06_D0
UART_Linux_BUART_sTX_TxShifter_u0__D1_REG EQU CYREG_B1_UDB06_D1
UART_Linux_BUART_sTX_TxShifter_u0__DP_AUX_CTL_REG EQU CYREG_B1_UDB06_ACTL
UART_Linux_BUART_sTX_TxShifter_u0__F0_F1_REG EQU CYREG_B1_UDB06_F0_F1
UART_Linux_BUART_sTX_TxShifter_u0__F0_REG EQU CYREG_B1_UDB06_F0
UART_Linux_BUART_sTX_TxShifter_u0__F1_REG EQU CYREG_B1_UDB06_F1
UART_Linux_BUART_sTX_TxSts__0__MASK EQU 0x01
UART_Linux_BUART_sTX_TxSts__0__POS EQU 0
UART_Linux_BUART_sTX_TxSts__1__MASK EQU 0x02
UART_Linux_BUART_sTX_TxSts__1__POS EQU 1
UART_Linux_BUART_sTX_TxSts__16BIT_STATUS_AUX_CTL_REG EQU CYREG_B1_UDB06_07_ACTL
UART_Linux_BUART_sTX_TxSts__16BIT_STATUS_REG EQU CYREG_B1_UDB06_07_ST
UART_Linux_BUART_sTX_TxSts__2__MASK EQU 0x04
UART_Linux_BUART_sTX_TxSts__2__POS EQU 2
UART_Linux_BUART_sTX_TxSts__3__MASK EQU 0x08
UART_Linux_BUART_sTX_TxSts__3__POS EQU 3
UART_Linux_BUART_sTX_TxSts__MASK EQU 0x0F
UART_Linux_BUART_sTX_TxSts__MASK_REG EQU CYREG_B1_UDB06_MSK
UART_Linux_BUART_sTX_TxSts__STATUS_AUX_CTL_REG EQU CYREG_B1_UDB06_ACTL
UART_Linux_BUART_sTX_TxSts__STATUS_REG EQU CYREG_B1_UDB06_ST
UART_Linux_IntClock__CFG0 EQU CYREG_CLKDIST_DCFG0_CFG0
UART_Linux_IntClock__CFG1 EQU CYREG_CLKDIST_DCFG0_CFG1
UART_Linux_IntClock__CFG2 EQU CYREG_CLKDIST_DCFG0_CFG2
UART_Linux_IntClock__CFG2_SRC_SEL_MASK EQU 0x07
UART_Linux_IntClock__INDEX EQU 0x00
UART_Linux_IntClock__PM_ACT_CFG EQU CYREG_PM_ACT_CFG2
UART_Linux_IntClock__PM_ACT_MSK EQU 0x01
UART_Linux_IntClock__PM_STBY_CFG EQU CYREG_PM_STBY_CFG2
UART_Linux_IntClock__PM_STBY_MSK EQU 0x01
UART_Linux_RXInternalInterrupt__INTC_CLR_EN_REG EQU CYREG_NVIC_CLRENA0
UART_Linux_RXInternalInterrupt__INTC_CLR_PD_REG EQU CYREG_NVIC_CLRPEND0
UART_Linux_RXInternalInterrupt__INTC_MASK EQU 0x04
UART_Linux_RXInternalInterrupt__INTC_NUMBER EQU 2
UART_Linux_RXInternalInterrupt__INTC_PRIOR_NUM EQU 7
UART_Linux_RXInternalInterrupt__INTC_PRIOR_REG EQU CYREG_NVIC_PRI_2
UART_Linux_RXInternalInterrupt__INTC_SET_EN_REG EQU CYREG_NVIC_SETENA0
UART_Linux_RXInternalInterrupt__INTC_SET_PD_REG EQU CYREG_NVIC_SETPEND0
UART_Linux_TXInternalInterrupt__INTC_CLR_EN_REG EQU CYREG_NVIC_CLRENA0
UART_Linux_TXInternalInterrupt__INTC_CLR_PD_REG EQU CYREG_NVIC_CLRPEND0
UART_Linux_TXInternalInterrupt__INTC_MASK EQU 0x08
UART_Linux_TXInternalInterrupt__INTC_NUMBER EQU 3
UART_Linux_TXInternalInterrupt__INTC_PRIOR_NUM EQU 7
UART_Linux_TXInternalInterrupt__INTC_PRIOR_REG EQU CYREG_NVIC_PRI_3
UART_Linux_TXInternalInterrupt__INTC_SET_EN_REG EQU CYREG_NVIC_SETENA0
UART_Linux_TXInternalInterrupt__INTC_SET_PD_REG EQU CYREG_NVIC_SETPEND0

; intr_Port1
intr_Port1__INTC_CLR_EN_REG EQU CYREG_NVIC_CLRENA0
intr_Port1__INTC_CLR_PD_REG EQU CYREG_NVIC_CLRPEND0
intr_Port1__INTC_MASK EQU 0x40
intr_Port1__INTC_NUMBER EQU 6
intr_Port1__INTC_PRIOR_NUM EQU 6
intr_Port1__INTC_PRIOR_REG EQU CYREG_NVIC_PRI_6
intr_Port1__INTC_SET_EN_REG EQU CYREG_NVIC_SETENA0
intr_Port1__INTC_SET_PD_REG EQU CYREG_NVIC_SETPEND0

; intr_Port2
intr_Port2__INTC_CLR_EN_REG EQU CYREG_NVIC_CLRENA0
intr_Port2__INTC_CLR_PD_REG EQU CYREG_NVIC_CLRPEND0
intr_Port2__INTC_MASK EQU 0x400
intr_Port2__INTC_NUMBER EQU 10
intr_Port2__INTC_PRIOR_NUM EQU 6
intr_Port2__INTC_PRIOR_REG EQU CYREG_NVIC_PRI_10
intr_Port2__INTC_SET_EN_REG EQU CYREG_NVIC_SETENA0
intr_Port2__INTC_SET_PD_REG EQU CYREG_NVIC_SETPEND0

; Relay_Port1
Relay_Port1__0__INTTYPE EQU CYREG_PICU2_INTTYPE6
Relay_Port1__0__MASK EQU 0x40
Relay_Port1__0__PC EQU CYREG_PRT2_PC6
Relay_Port1__0__PORT EQU 2
Relay_Port1__0__SHIFT EQU 6
Relay_Port1__AG EQU CYREG_PRT2_AG
Relay_Port1__AMUX EQU CYREG_PRT2_AMUX
Relay_Port1__BIE EQU CYREG_PRT2_BIE
Relay_Port1__BIT_MASK EQU CYREG_PRT2_BIT_MASK
Relay_Port1__BYP EQU CYREG_PRT2_BYP
Relay_Port1__CTL EQU CYREG_PRT2_CTL
Relay_Port1__DM0 EQU CYREG_PRT2_DM0
Relay_Port1__DM1 EQU CYREG_PRT2_DM1
Relay_Port1__DM2 EQU CYREG_PRT2_DM2
Relay_Port1__DR EQU CYREG_PRT2_DR
Relay_Port1__INP_DIS EQU CYREG_PRT2_INP_DIS
Relay_Port1__INTTYPE_BASE EQU CYDEV_PICU_INTTYPE_PICU2_BASE
Relay_Port1__LCD_COM_SEG EQU CYREG_PRT2_LCD_COM_SEG
Relay_Port1__LCD_EN EQU CYREG_PRT2_LCD_EN
Relay_Port1__MASK EQU 0x40
Relay_Port1__PORT EQU 2
Relay_Port1__PRT EQU CYREG_PRT2_PRT
Relay_Port1__PRTDSI__CAPS_SEL EQU CYREG_PRT2_CAPS_SEL
Relay_Port1__PRTDSI__DBL_SYNC_IN EQU CYREG_PRT2_DBL_SYNC_IN
Relay_Port1__PRTDSI__OE_SEL0 EQU CYREG_PRT2_OE_SEL0
Relay_Port1__PRTDSI__OE_SEL1 EQU CYREG_PRT2_OE_SEL1
Relay_Port1__PRTDSI__OUT_SEL0 EQU CYREG_PRT2_OUT_SEL0
Relay_Port1__PRTDSI__OUT_SEL1 EQU CYREG_PRT2_OUT_SEL1
Relay_Port1__PRTDSI__SYNC_OUT EQU CYREG_PRT2_SYNC_OUT
Relay_Port1__PS EQU CYREG_PRT2_PS
Relay_Port1__SHIFT EQU 6
Relay_Port1__SLW EQU CYREG_PRT2_SLW

; Relay_Port2
Relay_Port2__0__INTTYPE EQU CYREG_PICU5_INTTYPE0
Relay_Port2__0__MASK EQU 0x01
Relay_Port2__0__PC EQU CYREG_PRT5_PC0
Relay_Port2__0__PORT EQU 5
Relay_Port2__0__SHIFT EQU 0
Relay_Port2__AG EQU CYREG_PRT5_AG
Relay_Port2__AMUX EQU CYREG_PRT5_AMUX
Relay_Port2__BIE EQU CYREG_PRT5_BIE
Relay_Port2__BIT_MASK EQU CYREG_PRT5_BIT_MASK
Relay_Port2__BYP EQU CYREG_PRT5_BYP
Relay_Port2__CTL EQU CYREG_PRT5_CTL
Relay_Port2__DM0 EQU CYREG_PRT5_DM0
Relay_Port2__DM1 EQU CYREG_PRT5_DM1
Relay_Port2__DM2 EQU CYREG_PRT5_DM2
Relay_Port2__DR EQU CYREG_PRT5_DR
Relay_Port2__INP_DIS EQU CYREG_PRT5_INP_DIS
Relay_Port2__INTTYPE_BASE EQU CYDEV_PICU_INTTYPE_PICU5_BASE
Relay_Port2__LCD_COM_SEG EQU CYREG_PRT5_LCD_COM_SEG
Relay_Port2__LCD_EN EQU CYREG_PRT5_LCD_EN
Relay_Port2__MASK EQU 0x01
Relay_Port2__PORT EQU 5
Relay_Port2__PRT EQU CYREG_PRT5_PRT
Relay_Port2__PRTDSI__CAPS_SEL EQU CYREG_PRT5_CAPS_SEL
Relay_Port2__PRTDSI__DBL_SYNC_IN EQU CYREG_PRT5_DBL_SYNC_IN
Relay_Port2__PRTDSI__OE_SEL0 EQU CYREG_PRT5_OE_SEL0
Relay_Port2__PRTDSI__OE_SEL1 EQU CYREG_PRT5_OE_SEL1
Relay_Port2__PRTDSI__OUT_SEL0 EQU CYREG_PRT5_OUT_SEL0
Relay_Port2__PRTDSI__OUT_SEL1 EQU CYREG_PRT5_OUT_SEL1
Relay_Port2__PRTDSI__SYNC_OUT EQU CYREG_PRT5_SYNC_OUT
Relay_Port2__PS EQU CYREG_PRT5_PS
Relay_Port2__SHIFT EQU 0
Relay_Port2__SLW EQU CYREG_PRT5_SLW

; Rx_UART_Linux
Rx_UART_Linux__0__INTTYPE EQU CYREG_PICU3_INTTYPE1
Rx_UART_Linux__0__MASK EQU 0x02
Rx_UART_Linux__0__PC EQU CYREG_PRT3_PC1
Rx_UART_Linux__0__PORT EQU 3
Rx_UART_Linux__0__SHIFT EQU 1
Rx_UART_Linux__AG EQU CYREG_PRT3_AG
Rx_UART_Linux__AMUX EQU CYREG_PRT3_AMUX
Rx_UART_Linux__BIE EQU CYREG_PRT3_BIE
Rx_UART_Linux__BIT_MASK EQU CYREG_PRT3_BIT_MASK
Rx_UART_Linux__BYP EQU CYREG_PRT3_BYP
Rx_UART_Linux__CTL EQU CYREG_PRT3_CTL
Rx_UART_Linux__DM0 EQU CYREG_PRT3_DM0
Rx_UART_Linux__DM1 EQU CYREG_PRT3_DM1
Rx_UART_Linux__DM2 EQU CYREG_PRT3_DM2
Rx_UART_Linux__DR EQU CYREG_PRT3_DR
Rx_UART_Linux__INP_DIS EQU CYREG_PRT3_INP_DIS
Rx_UART_Linux__INTTYPE_BASE EQU CYDEV_PICU_INTTYPE_PICU3_BASE
Rx_UART_Linux__LCD_COM_SEG EQU CYREG_PRT3_LCD_COM_SEG
Rx_UART_Linux__LCD_EN EQU CYREG_PRT3_LCD_EN
Rx_UART_Linux__MASK EQU 0x02
Rx_UART_Linux__PORT EQU 3
Rx_UART_Linux__PRT EQU CYREG_PRT3_PRT
Rx_UART_Linux__PRTDSI__CAPS_SEL EQU CYREG_PRT3_CAPS_SEL
Rx_UART_Linux__PRTDSI__DBL_SYNC_IN EQU CYREG_PRT3_DBL_SYNC_IN
Rx_UART_Linux__PRTDSI__OE_SEL0 EQU CYREG_PRT3_OE_SEL0
Rx_UART_Linux__PRTDSI__OE_SEL1 EQU CYREG_PRT3_OE_SEL1
Rx_UART_Linux__PRTDSI__OUT_SEL0 EQU CYREG_PRT3_OUT_SEL0
Rx_UART_Linux__PRTDSI__OUT_SEL1 EQU CYREG_PRT3_OUT_SEL1
Rx_UART_Linux__PRTDSI__SYNC_OUT EQU CYREG_PRT3_SYNC_OUT
Rx_UART_Linux__PS EQU CYREG_PRT3_PS
Rx_UART_Linux__SHIFT EQU 1
Rx_UART_Linux__SLW EQU CYREG_PRT3_SLW

; Tx_UART_Linux
Tx_UART_Linux__0__INTTYPE EQU CYREG_PICU3_INTTYPE0
Tx_UART_Linux__0__MASK EQU 0x01
Tx_UART_Linux__0__PC EQU CYREG_PRT3_PC0
Tx_UART_Linux__0__PORT EQU 3
Tx_UART_Linux__0__SHIFT EQU 0
Tx_UART_Linux__AG EQU CYREG_PRT3_AG
Tx_UART_Linux__AMUX EQU CYREG_PRT3_AMUX
Tx_UART_Linux__BIE EQU CYREG_PRT3_BIE
Tx_UART_Linux__BIT_MASK EQU CYREG_PRT3_BIT_MASK
Tx_UART_Linux__BYP EQU CYREG_PRT3_BYP
Tx_UART_Linux__CTL EQU CYREG_PRT3_CTL
Tx_UART_Linux__DM0 EQU CYREG_PRT3_DM0
Tx_UART_Linux__DM1 EQU CYREG_PRT3_DM1
Tx_UART_Linux__DM2 EQU CYREG_PRT3_DM2
Tx_UART_Linux__DR EQU CYREG_PRT3_DR
Tx_UART_Linux__INP_DIS EQU CYREG_PRT3_INP_DIS
Tx_UART_Linux__INTTYPE_BASE EQU CYDEV_PICU_INTTYPE_PICU3_BASE
Tx_UART_Linux__LCD_COM_SEG EQU CYREG_PRT3_LCD_COM_SEG
Tx_UART_Linux__LCD_EN EQU CYREG_PRT3_LCD_EN
Tx_UART_Linux__MASK EQU 0x01
Tx_UART_Linux__PORT EQU 3
Tx_UART_Linux__PRT EQU CYREG_PRT3_PRT
Tx_UART_Linux__PRTDSI__CAPS_SEL EQU CYREG_PRT3_CAPS_SEL
Tx_UART_Linux__PRTDSI__DBL_SYNC_IN EQU CYREG_PRT3_DBL_SYNC_IN
Tx_UART_Linux__PRTDSI__OE_SEL0 EQU CYREG_PRT3_OE_SEL0
Tx_UART_Linux__PRTDSI__OE_SEL1 EQU CYREG_PRT3_OE_SEL1
Tx_UART_Linux__PRTDSI__OUT_SEL0 EQU CYREG_PRT3_OUT_SEL0
Tx_UART_Linux__PRTDSI__OUT_SEL1 EQU CYREG_PRT3_OUT_SEL1
Tx_UART_Linux__PRTDSI__SYNC_OUT EQU CYREG_PRT3_SYNC_OUT
Tx_UART_Linux__PS EQU CYREG_PRT3_PS
Tx_UART_Linux__SHIFT EQU 0
Tx_UART_Linux__SLW EQU CYREG_PRT3_SLW

; Rx_UART_Debaug
Rx_UART_Debaug__0__INTTYPE EQU CYREG_PICU12_INTTYPE0
Rx_UART_Debaug__0__MASK EQU 0x01
Rx_UART_Debaug__0__PC EQU CYREG_PRT12_PC0
Rx_UART_Debaug__0__PORT EQU 12
Rx_UART_Debaug__0__SHIFT EQU 0
Rx_UART_Debaug__AG EQU CYREG_PRT12_AG
Rx_UART_Debaug__BIE EQU CYREG_PRT12_BIE
Rx_UART_Debaug__BIT_MASK EQU CYREG_PRT12_BIT_MASK
Rx_UART_Debaug__BYP EQU CYREG_PRT12_BYP
Rx_UART_Debaug__DM0 EQU CYREG_PRT12_DM0
Rx_UART_Debaug__DM1 EQU CYREG_PRT12_DM1
Rx_UART_Debaug__DM2 EQU CYREG_PRT12_DM2
Rx_UART_Debaug__DR EQU CYREG_PRT12_DR
Rx_UART_Debaug__INP_DIS EQU CYREG_PRT12_INP_DIS
Rx_UART_Debaug__INTTYPE_BASE EQU CYDEV_PICU_INTTYPE_PICU12_BASE
Rx_UART_Debaug__MASK EQU 0x01
Rx_UART_Debaug__PORT EQU 12
Rx_UART_Debaug__PRT EQU CYREG_PRT12_PRT
Rx_UART_Debaug__PRTDSI__DBL_SYNC_IN EQU CYREG_PRT12_DBL_SYNC_IN
Rx_UART_Debaug__PRTDSI__OE_SEL0 EQU CYREG_PRT12_OE_SEL0
Rx_UART_Debaug__PRTDSI__OE_SEL1 EQU CYREG_PRT12_OE_SEL1
Rx_UART_Debaug__PRTDSI__OUT_SEL0 EQU CYREG_PRT12_OUT_SEL0
Rx_UART_Debaug__PRTDSI__OUT_SEL1 EQU CYREG_PRT12_OUT_SEL1
Rx_UART_Debaug__PRTDSI__SYNC_OUT EQU CYREG_PRT12_SYNC_OUT
Rx_UART_Debaug__PS EQU CYREG_PRT12_PS
Rx_UART_Debaug__SHIFT EQU 0
Rx_UART_Debaug__SIO_CFG EQU CYREG_PRT12_SIO_CFG
Rx_UART_Debaug__SIO_DIFF EQU CYREG_PRT12_SIO_DIFF
Rx_UART_Debaug__SIO_HYST_EN EQU CYREG_PRT12_SIO_HYST_EN
Rx_UART_Debaug__SIO_REG_HIFREQ EQU CYREG_PRT12_SIO_REG_HIFREQ
Rx_UART_Debaug__SLW EQU CYREG_PRT12_SLW

; Tx_UART_Debaug
Tx_UART_Debaug__0__INTTYPE EQU CYREG_PICU12_INTTYPE1
Tx_UART_Debaug__0__MASK EQU 0x02
Tx_UART_Debaug__0__PC EQU CYREG_PRT12_PC1
Tx_UART_Debaug__0__PORT EQU 12
Tx_UART_Debaug__0__SHIFT EQU 1
Tx_UART_Debaug__AG EQU CYREG_PRT12_AG
Tx_UART_Debaug__BIE EQU CYREG_PRT12_BIE
Tx_UART_Debaug__BIT_MASK EQU CYREG_PRT12_BIT_MASK
Tx_UART_Debaug__BYP EQU CYREG_PRT12_BYP
Tx_UART_Debaug__DM0 EQU CYREG_PRT12_DM0
Tx_UART_Debaug__DM1 EQU CYREG_PRT12_DM1
Tx_UART_Debaug__DM2 EQU CYREG_PRT12_DM2
Tx_UART_Debaug__DR EQU CYREG_PRT12_DR
Tx_UART_Debaug__INP_DIS EQU CYREG_PRT12_INP_DIS
Tx_UART_Debaug__INTTYPE_BASE EQU CYDEV_PICU_INTTYPE_PICU12_BASE
Tx_UART_Debaug__MASK EQU 0x02
Tx_UART_Debaug__PORT EQU 12
Tx_UART_Debaug__PRT EQU CYREG_PRT12_PRT
Tx_UART_Debaug__PRTDSI__DBL_SYNC_IN EQU CYREG_PRT12_DBL_SYNC_IN
Tx_UART_Debaug__PRTDSI__OE_SEL0 EQU CYREG_PRT12_OE_SEL0
Tx_UART_Debaug__PRTDSI__OE_SEL1 EQU CYREG_PRT12_OE_SEL1
Tx_UART_Debaug__PRTDSI__OUT_SEL0 EQU CYREG_PRT12_OUT_SEL0
Tx_UART_Debaug__PRTDSI__OUT_SEL1 EQU CYREG_PRT12_OUT_SEL1
Tx_UART_Debaug__PRTDSI__SYNC_OUT EQU CYREG_PRT12_SYNC_OUT
Tx_UART_Debaug__PS EQU CYREG_PRT12_PS
Tx_UART_Debaug__SHIFT EQU 1
Tx_UART_Debaug__SIO_CFG EQU CYREG_PRT12_SIO_CFG
Tx_UART_Debaug__SIO_DIFF EQU CYREG_PRT12_SIO_DIFF
Tx_UART_Debaug__SIO_HYST_EN EQU CYREG_PRT12_SIO_HYST_EN
Tx_UART_Debaug__SIO_REG_HIFREQ EQU CYREG_PRT12_SIO_REG_HIFREQ
Tx_UART_Debaug__SLW EQU CYREG_PRT12_SLW

; intr_UART_Linux_Rx
intr_UART_Linux_Rx__INTC_CLR_EN_REG EQU CYREG_NVIC_CLRENA0
intr_UART_Linux_Rx__INTC_CLR_PD_REG EQU CYREG_NVIC_CLRPEND0
intr_UART_Linux_Rx__INTC_MASK EQU 0x10
intr_UART_Linux_Rx__INTC_NUMBER EQU 4
intr_UART_Linux_Rx__INTC_PRIOR_NUM EQU 7
intr_UART_Linux_Rx__INTC_PRIOR_REG EQU CYREG_NVIC_PRI_4
intr_UART_Linux_Rx__INTC_SET_EN_REG EQU CYREG_NVIC_SETENA0
intr_UART_Linux_Rx__INTC_SET_PD_REG EQU CYREG_NVIC_SETPEND0

; Miscellaneous
BCLK__BUS_CLK__HZ EQU 48000000
BCLK__BUS_CLK__KHZ EQU 48000
BCLK__BUS_CLK__MHZ EQU 48
CYDEV_CHIP_DIE_LEOPARD EQU 1
CYDEV_CHIP_DIE_PSOC4A EQU 26
CYDEV_CHIP_DIE_PSOC5LP EQU 2
CYDEV_CHIP_DIE_PSOC5TM EQU 3
CYDEV_CHIP_DIE_TMA4 EQU 4
CYDEV_CHIP_DIE_UNKNOWN EQU 0
CYDEV_CHIP_FAMILY_FM0P EQU 5
CYDEV_CHIP_FAMILY_FM3 EQU 6
CYDEV_CHIP_FAMILY_FM4 EQU 7
CYDEV_CHIP_FAMILY_PSOC3 EQU 1
CYDEV_CHIP_FAMILY_PSOC4 EQU 2
CYDEV_CHIP_FAMILY_PSOC5 EQU 3
CYDEV_CHIP_FAMILY_PSOC6 EQU 4
CYDEV_CHIP_FAMILY_UNKNOWN EQU 0
CYDEV_CHIP_FAMILY_USED EQU CYDEV_CHIP_FAMILY_PSOC5
CYDEV_CHIP_JTAG_ID EQU 0x2E123069
CYDEV_CHIP_MEMBER_3A EQU 1
CYDEV_CHIP_MEMBER_4A EQU 26
CYDEV_CHIP_MEMBER_4AA EQU 25
CYDEV_CHIP_MEMBER_4AB EQU 30
CYDEV_CHIP_MEMBER_4AC EQU 14
CYDEV_CHIP_MEMBER_4AD EQU 15
CYDEV_CHIP_MEMBER_4AE EQU 16
CYDEV_CHIP_MEMBER_4D EQU 20
CYDEV_CHIP_MEMBER_4E EQU 6
CYDEV_CHIP_MEMBER_4F EQU 27
CYDEV_CHIP_MEMBER_4G EQU 4
CYDEV_CHIP_MEMBER_4H EQU 24
CYDEV_CHIP_MEMBER_4I EQU 32
CYDEV_CHIP_MEMBER_4J EQU 21
CYDEV_CHIP_MEMBER_4K EQU 22
CYDEV_CHIP_MEMBER_4L EQU 31
CYDEV_CHIP_MEMBER_4M EQU 29
CYDEV_CHIP_MEMBER_4N EQU 11
CYDEV_CHIP_MEMBER_4O EQU 8
CYDEV_CHIP_MEMBER_4P EQU 28
CYDEV_CHIP_MEMBER_4Q EQU 17
CYDEV_CHIP_MEMBER_4R EQU 9
CYDEV_CHIP_MEMBER_4S EQU 12
CYDEV_CHIP_MEMBER_4T EQU 10
CYDEV_CHIP_MEMBER_4U EQU 5
CYDEV_CHIP_MEMBER_4V EQU 23
CYDEV_CHIP_MEMBER_4W EQU 13
CYDEV_CHIP_MEMBER_4X EQU 7
CYDEV_CHIP_MEMBER_4Y EQU 18
CYDEV_CHIP_MEMBER_4Z EQU 19
CYDEV_CHIP_MEMBER_5A EQU 3
CYDEV_CHIP_MEMBER_5B EQU 2
CYDEV_CHIP_MEMBER_6A EQU 33
CYDEV_CHIP_MEMBER_FM3 EQU 37
CYDEV_CHIP_MEMBER_FM4 EQU 38
CYDEV_CHIP_MEMBER_PDL_FM0P_TYPE1 EQU 34
CYDEV_CHIP_MEMBER_PDL_FM0P_TYPE2 EQU 35
CYDEV_CHIP_MEMBER_PDL_FM0P_TYPE3 EQU 36
CYDEV_CHIP_MEMBER_UNKNOWN EQU 0
CYDEV_CHIP_MEMBER_USED EQU CYDEV_CHIP_MEMBER_5B
CYDEV_CHIP_DIE_EXPECT EQU CYDEV_CHIP_MEMBER_USED
CYDEV_CHIP_DIE_ACTUAL EQU CYDEV_CHIP_DIE_EXPECT
CYDEV_CHIP_REV_LEOPARD_ES1 EQU 0
CYDEV_CHIP_REV_LEOPARD_ES2 EQU 1
CYDEV_CHIP_REV_LEOPARD_ES3 EQU 3
CYDEV_CHIP_REV_LEOPARD_PRODUCTION EQU 3
CYDEV_CHIP_REV_PSOC4A_ES0 EQU 17
CYDEV_CHIP_REV_PSOC4A_PRODUCTION EQU 17
CYDEV_CHIP_REV_PSOC5LP_ES0 EQU 0
CYDEV_CHIP_REV_PSOC5LP_PRODUCTION EQU 0
CYDEV_CHIP_REV_PSOC5TM_ES0 EQU 0
CYDEV_CHIP_REV_PSOC5TM_ES1 EQU 1
CYDEV_CHIP_REV_PSOC5TM_PRODUCTION EQU 1
CYDEV_CHIP_REV_TMA4_ES EQU 17
CYDEV_CHIP_REV_TMA4_ES2 EQU 33
CYDEV_CHIP_REV_TMA4_PRODUCTION EQU 17
CYDEV_CHIP_REVISION_3A_ES1 EQU 0
CYDEV_CHIP_REVISION_3A_ES2 EQU 1
CYDEV_CHIP_REVISION_3A_ES3 EQU 3
CYDEV_CHIP_REVISION_3A_PRODUCTION EQU 3
CYDEV_CHIP_REVISION_4A_ES0 EQU 17
CYDEV_CHIP_REVISION_4A_PRODUCTION EQU 17
CYDEV_CHIP_REVISION_4AA_PRODUCTION EQU 0
CYDEV_CHIP_REVISION_4AB_PRODUCTION EQU 0
CYDEV_CHIP_REVISION_4AC_PRODUCTION EQU 0
CYDEV_CHIP_REVISION_4AD_PRODUCTION EQU 0
CYDEV_CHIP_REVISION_4AE_PRODUCTION EQU 0
CYDEV_CHIP_REVISION_4D_PRODUCTION EQU 0
CYDEV_CHIP_REVISION_4E_CCG2_NO_USBPD EQU 0
CYDEV_CHIP_REVISION_4E_PRODUCTION EQU 0
CYDEV_CHIP_REVISION_4F_PRODUCTION EQU 0
CYDEV_CHIP_REVISION_4F_PRODUCTION_256DMA EQU 0
CYDEV_CHIP_REVISION_4F_PRODUCTION_256K EQU 0
CYDEV_CHIP_REVISION_4G_ES EQU 17
CYDEV_CHIP_REVISION_4G_ES2 EQU 33
CYDEV_CHIP_REVISION_4G_PRODUCTION EQU 17
CYDEV_CHIP_REVISION_4H_PRODUCTION EQU 0
CYDEV_CHIP_REVISION_4I_PRODUCTION EQU 0
CYDEV_CHIP_REVISION_4J_PRODUCTION EQU 0
CYDEV_CHIP_REVISION_4K_PRODUCTION EQU 0
CYDEV_CHIP_REVISION_4L_PRODUCTION EQU 0
CYDEV_CHIP_REVISION_4M_PRODUCTION EQU 0
CYDEV_CHIP_REVISION_4N_PRODUCTION EQU 0
CYDEV_CHIP_REVISION_4O_PRODUCTION EQU 0
CYDEV_CHIP_REVISION_4P_PRODUCTION EQU 0
CYDEV_CHIP_REVISION_4Q_PRODUCTION EQU 0
CYDEV_CHIP_REVISION_4R_PRODUCTION EQU 0
CYDEV_CHIP_REVISION_4S_PRODUCTION EQU 0
CYDEV_CHIP_REVISION_4T_PRODUCTION EQU 0
CYDEV_CHIP_REVISION_4U_PRODUCTION EQU 0
CYDEV_CHIP_REVISION_4V_PRODUCTION EQU 0
CYDEV_CHIP_REVISION_4W_PRODUCTION EQU 0
CYDEV_CHIP_REVISION_4X_PRODUCTION EQU 0
CYDEV_CHIP_REVISION_4Y_PRODUCTION EQU 0
CYDEV_CHIP_REVISION_4Z_PRODUCTION EQU 0
CYDEV_CHIP_REVISION_5A_ES0 EQU 0
CYDEV_CHIP_REVISION_5A_ES1 EQU 1
CYDEV_CHIP_REVISION_5A_PRODUCTION EQU 1
CYDEV_CHIP_REVISION_5B_ES0 EQU 0
CYDEV_CHIP_REVISION_5B_PRODUCTION EQU 0
CYDEV_CHIP_REVISION_6A_ES EQU 17
CYDEV_CHIP_REVISION_6A_NO_UDB EQU 33
CYDEV_CHIP_REVISION_6A_PRODUCTION EQU 33
CYDEV_CHIP_REVISION_FM3_PRODUCTION EQU 0
CYDEV_CHIP_REVISION_FM4_PRODUCTION EQU 0
CYDEV_CHIP_REVISION_PDL_FM0P_TYPE1_PRODUCTION EQU 0
CYDEV_CHIP_REVISION_PDL_FM0P_TYPE2_PRODUCTION EQU 0
CYDEV_CHIP_REVISION_PDL_FM0P_TYPE3_PRODUCTION EQU 0
CYDEV_CHIP_REVISION_USED EQU CYDEV_CHIP_REVISION_5B_PRODUCTION
CYDEV_CHIP_REV_EXPECT EQU CYDEV_CHIP_REVISION_USED
CYDEV_CONFIG_FASTBOOT_ENABLED EQU 1
CYDEV_CONFIG_UNUSED_IO_AllowButWarn EQU 0
CYDEV_CONFIG_UNUSED_IO EQU CYDEV_CONFIG_UNUSED_IO_AllowButWarn
CYDEV_CONFIG_UNUSED_IO_AllowWithInfo EQU 1
CYDEV_CONFIG_UNUSED_IO_Disallowed EQU 2
CYDEV_CONFIGURATION_COMPRESSED EQU 1
CYDEV_CONFIGURATION_DMA EQU 0
CYDEV_CONFIGURATION_ECC EQU 1
CYDEV_CONFIGURATION_IMOENABLED EQU CYDEV_CONFIG_FASTBOOT_ENABLED
CYDEV_CONFIGURATION_MODE_COMPRESSED EQU 0
CYDEV_CONFIGURATION_MODE EQU CYDEV_CONFIGURATION_MODE_COMPRESSED
CYDEV_CONFIGURATION_MODE_DMA EQU 2
CYDEV_CONFIGURATION_MODE_UNCOMPRESSED EQU 1
CYDEV_DEBUG_ENABLE_MASK EQU 0x20
CYDEV_DEBUG_ENABLE_REGISTER EQU CYREG_MLOGIC_DEBUG
CYDEV_DEBUGGING_DPS_SWD EQU 2
CYDEV_DEBUGGING_DPS_SWD_SWV EQU 6
CYDEV_DEBUGGING_DPS EQU CYDEV_DEBUGGING_DPS_SWD_SWV
CYDEV_DEBUGGING_ENABLE EQU 1
CYDEV_DEBUGGING_XRES EQU 0
CYDEV_DMA_CHANNELS_AVAILABLE EQU 24
CYDEV_ECC_ENABLE EQU 1
CYDEV_HEAP_SIZE EQU 0x400
CYDEV_INSTRUCT_CACHE_ENABLED EQU 1
CYDEV_INTR_RISING EQU 0x0000001F
CYDEV_IS_EXPORTING_CODE EQU 0
CYDEV_IS_IMPORTING_CODE EQU 0
CYDEV_PROJ_TYPE EQU 2
CYDEV_PROJ_TYPE_BOOTLOADER EQU 1
CYDEV_PROJ_TYPE_LAUNCHER EQU 5
CYDEV_PROJ_TYPE_LOADABLE EQU 2
CYDEV_PROJ_TYPE_LOADABLEANDBOOTLOADER EQU 4
CYDEV_PROJ_TYPE_MULTIAPPBOOTLOADER EQU 3
CYDEV_PROJ_TYPE_STANDARD EQU 0
CYDEV_PROTECTION_ENABLE EQU 0
CYDEV_STACK_SIZE EQU 0x200
CYDEV_USB_CLK_OSC_LOCKING_ENABLED_AT_PWR_UP EQU 1
CYDEV_USE_BUNDLED_CMSIS EQU 1
CYDEV_VARIABLE_VDDA EQU 0
CYDEV_VDDA_MV EQU 5000
CYDEV_VDDD_MV EQU 5000
CYDEV_VDDIO0_MV EQU 5000
CYDEV_VDDIO1_MV EQU 5000
CYDEV_VDDIO2_MV EQU 5000
CYDEV_VDDIO3_MV EQU 5000
CYDEV_VIO0_MV EQU 5000
CYDEV_VIO1_MV EQU 5000
CYDEV_VIO2_MV EQU 5000
CYDEV_VIO3_MV EQU 5000
CYIPBLOCK_ARM_CM3_VERSION EQU 0
CYIPBLOCK_P3_ANAIF_VERSION EQU 0
CYIPBLOCK_P3_CAN_VERSION EQU 0
CYIPBLOCK_P3_CAPSENSE_VERSION EQU 0
CYIPBLOCK_P3_COMP_VERSION EQU 0
CYIPBLOCK_P3_DECIMATOR_VERSION EQU 0
CYIPBLOCK_P3_DFB_VERSION EQU 0
CYIPBLOCK_P3_DMA_VERSION EQU 0
CYIPBLOCK_P3_DRQ_VERSION EQU 0
CYIPBLOCK_P3_DSM_VERSION EQU 0
CYIPBLOCK_P3_EMIF_VERSION EQU 0
CYIPBLOCK_P3_I2C_VERSION EQU 0
CYIPBLOCK_P3_LCD_VERSION EQU 0
CYIPBLOCK_P3_LPF_VERSION EQU 0
CYIPBLOCK_P3_OPAMP_VERSION EQU 0
CYIPBLOCK_P3_PM_VERSION EQU 0
CYIPBLOCK_P3_SCCT_VERSION EQU 0
CYIPBLOCK_P3_TIMER_VERSION EQU 0
CYIPBLOCK_P3_USB_VERSION EQU 0
CYIPBLOCK_P3_VIDAC_VERSION EQU 0
CYIPBLOCK_P3_VREF_VERSION EQU 0
CYIPBLOCK_S8_GPIO_VERSION EQU 0
CYIPBLOCK_S8_IRQ_VERSION EQU 0
CYIPBLOCK_S8_SAR_VERSION EQU 0
CYIPBLOCK_S8_SIO_VERSION EQU 0
CYIPBLOCK_S8_UDB_VERSION EQU 0
DMA_CHANNELS_USED__MASK0 EQU 0x00000000
CYDEV_BOOTLOADER_ENABLE EQU 0
    ENDIF
    END
